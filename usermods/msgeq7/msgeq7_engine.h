/*
 * msgeq7_engine.h — MSGEQ7 signal processing and hardware protocol
 *
 * All code here is independent of the WLED usermod API and can be transplanted
 * into a different host (e.g. the audioreactive usermod) by including this
 * header after wled.h and audio_source.h.
 *
 * Contents:
 *   - Physical constants for the 7 MSGEQ7 bands
 *   - Shared volatile output state (written by the engine, read by the usermod)
 *   - 7-band → 16-channel GEQ interpolation table (buildInterpolationTable)
 *   - Biquad bandpass filter bank + peak-hold envelope detector
 *   - FreeRTOS software processing task (I2S → filter → compress → shared state)
 *   - Physical MSGEQ7 chip GPIO protocol (msgeq7_hw_gpio_init, msgeq7_hw_read)
 *
 * Prerequisites: include wled.h and audio_source.h before this header.
 *
 * AI: below section was generated by an AI
 */

#pragma once

// ── IMPORTANT: single-include header ─────────────────────────────────────────
// All state variables and functions below are declared `static` (internal
// linkage). This header is designed to be included from EXACTLY ONE translation
// unit (msgeq7.cpp). Including it in a second TU would create independent
// copies of all state, silently breaking the SW task's stop mechanism and the
// band-envelope data that the usermod reads.
// If this code is transplanted into a larger host, convert the definitions to
// a proper .cpp file with `extern` declarations in the header.
// ─────────────────────────────────────────────────────────────────────────────

// AudioSource is defined in audio_source.h — include that before this header.
class AudioSource;

#include <dsps_biquad_gen.h>
#include <dsps_biquad.h>

// ─── Constants ───────────────────────────────────────────────────────────────

// Software backend sample rate. Must be ≥ 32000 Hz to represent the 16 kHz band.
// 44100 Hz is the standard CD audio rate and gives a comfortable margin above 16 kHz.
static constexpr uint32_t MSGEQ7_SAMPLE_RATE         = 44100;

// I2S DMA block size (samples per read). Chosen to match audioreactive.
static constexpr int      MSGEQ7_BLOCK_SIZE           = 128;

// Number of MSGEQ7 frequency bands.
static constexpr int      NUM_BANDS                   = 7;

// Number of GEQ output channels expected by WLED effects.
static constexpr int      NUM_GEQ_CHANNELS            = 16;

// Center frequencies of the 7 MSGEQ7 bandpass filters (Hz).
// Source: MSGEQ7 datasheet (Mixed Signal Integration MSI, Inc.).
static constexpr float MSGEQ7_FREQS_HZ[NUM_BANDS] = {
  63.0f, 160.0f, 400.0f, 1000.0f, 2500.0f, 6250.0f, 16000.0f
};

// Default filter Q (quality factor). Real MSGEQ7 bands are spaced by a factor
// of 2.5 (≈1.32 octaves) and overlap noticeably; the corresponding Q for
// non-overlapping bandpasses at this spacing is Q = sqrt(2^N)/(2^N − 1) ≈ 1.05
// with N = 1.32 octaves. Q = 1.0 closely matches the chip's response — slightly
// wider than 1.05 to give modest band overlap as the real chip exhibits.
static constexpr float MSGEQ7_DEFAULT_Q = 1.0f;

// Envelope detector time constants (seconds).
// Approximate real MSGEQ7 peak-hold behaviour: fast attack, slow decay.
static constexpr float MSGEQ7_ATTACK_SEC = 0.015f;  // 15 ms attack
static constexpr float MSGEQ7_DECAY_SEC  = 0.080f;  // 80 ms decay

// Log compression: output = 255 * log10(1 + LOG_SCALE * x) / log10(1 + LOG_SCALE)
// LOG_SCALE = 9 maps linear 0..1 → compressed 0..1 with more resolution at low
// levels, matching the real chip's logarithmic output characteristic.
static constexpr float MSGEQ7_LOG_SCALE = 9.0f;

// FreeRTOS task settings for the software processing task.
static constexpr uint8_t  MSGEQ7_TASK_PRIORITY       = 1;
static constexpr uint32_t MSGEQ7_TASK_STACK          = 3072;  // bytes

// Minimum ms between hardware MSGEQ7 chip reads (~50 Hz update rate).
static constexpr uint32_t MSGEQ7_HW_READ_INTERVAL_MS = 20;

// Beat detection: trigger samplePeak when sub-bass energy rises faster than
// this fraction of full scale per update interval.
static constexpr float MSGEQ7_PEAK_RISE_THRESHOLD = 0.15f;

// ─── Shared output state ─────────────────────────────────────────────────────
//
// Written exclusively by softwareProcessingTask (SW path) or msgeq7_hw_read
// (HW path). Read exclusively by the usermod's loop().
// Single-writer / single-reader → volatile is sufficient; no mutex needed.

static volatile float    s_bandEnvelope[NUM_BANDS] = {};  // 0.0–255.0 per band
static volatile float    s_volumeSmth    = 0.0f;
static volatile uint16_t s_volumeRaw     = 0;
static volatile float    s_FFT_MajorPeak = 1.0f;
static volatile float    s_my_magnitude  = 0.001f;
static volatile uint8_t  s_samplePeak    = 0;

// Writable by effects via um_data pointers (matches audioreactive layout).
static uint8_t  s_maxVol = 31;
static uint8_t  s_binNum = 8;

// ─── GEQ interpolation table: 7 bands → 16 channels ─────────────────────────
//
// Each of the 16 GEQ output channels is assigned a representative frequency
// derived from audioreactive's FFT bin groupings at 22050 Hz. We locate the
// two bracketing MSGEQ7 bands and store a linear interpolation weight in
// log-frequency space. Built once in setup(); applied each loop().

struct GEQInterp {
  uint8_t lo;   // lower MSGEQ7 band index
  uint8_t hi;   // upper MSGEQ7 band index (lo + 1, clamped to NUM_BANDS - 1)
  float   t;    // blend weight towards hi: output = lo_val*(1-t) + hi_val*t
};

static GEQInterp s_geqInterp[NUM_GEQ_CHANNELS];

// Representative center frequencies for the 16 GEQ output channels (Hz).
// Derived from audioreactive's fftAddAvg() bin ranges at 22050 Hz / 512 bins
// (43.07 Hz per bin); center = (from + to) / 2 * 43.07.
static constexpr float GEQ_TARGET_FREQS_HZ[NUM_GEQ_CHANNELS] = {
    64.6f,   107.7f,  172.3f,  258.4f,
   344.5f,   472.8f,  667.9f,  926.0f,
  1291.0f,  1829.7f, 2561.6f, 3638.3f,
  5229.9f,  7468.5f, 9117.0f, 12903.0f
};

// Build s_geqInterp[] from GEQ_TARGET_FREQS_HZ and MSGEQ7_FREQS_HZ.
// Uses log10 scale so perceptually equal frequency spacings map linearly.
static void buildInterpolationTable(void) {
  float logBands[NUM_BANDS];
  for (int b = 0; b < NUM_BANDS; b++) logBands[b] = log10f(MSGEQ7_FREQS_HZ[b]);

  for (int ch = 0; ch < NUM_GEQ_CHANNELS; ch++) {
    float logTarget = log10f(GEQ_TARGET_FREQS_HZ[ch]);
    int lo = 0;
    for (int b = 0; b < NUM_BANDS - 1; b++) {
      if (logBands[b] <= logTarget) lo = b;
    }
    int   hi = (lo + 1 < NUM_BANDS) ? lo + 1 : NUM_BANDS - 1;
    float t  = 0.0f;
    if (hi != lo) {
      t = (logTarget - logBands[lo]) / (logBands[hi] - logBands[lo]);
      if (t < 0.0f) t = 0.0f;
      if (t > 1.0f) t = 1.0f;
    }
    s_geqInterp[ch] = { (uint8_t)lo, (uint8_t)hi, t };
  }
}

// ─── Biquad bandpass filter bank ─────────────────────────────────────────────
//
// One second-order IIR bandpass filter per MSGEQ7 band, implemented with the
// esp-dsp biquad routines. The SIMD-accelerated variants (ae32 / aes3) are
// selected at compile time where available.

// esp-dsp biquad requires 16-byte-aligned coefficient and delay-line arrays.
struct alignas(16) BandFilter {
  float coeffs[5];  // {b0, b1, b2, a1, a2} from dsps_biquad_gen_bpf_f32()
  float w[2];       // IIR delay line state, zeroed on init / reinit
};

static BandFilter s_filters[NUM_BANDS];

// Compute biquad coefficients for all 7 bands at the given sample rate and Q.
// Zeroes the delay lines. Call once at startup and whenever Q changes.
static void initBiquadCoeffs(float sampleRate, float Q) {
  for (int b = 0; b < NUM_BANDS; b++) {
    // Normalised frequency for esp-dsp: f = fc / fs, range [0 .. 0.5).
    // The 16 kHz band at 44100 Hz gives f ≈ 0.363 — well within range.
    float f = MSGEQ7_FREQS_HZ[b] / sampleRate;
    if (f >= 0.5f) f = 0.499f;  // hard clamp below Nyquist
    dsps_biquad_gen_bpf_f32(s_filters[b].coeffs, f, Q);
    s_filters[b].w[0] = 0.0f;
    s_filters[b].w[1] = 0.0f;
  }
}

// Convert a time constant (seconds) to a one-pole IIR coefficient.
// coeff = 1 − exp(−1 / (tau * fs)); near 0 = slow, near 1 = fast.
static float timeConstToCoeff(float timeConst_s, float sampleRate) {
  return 1.0f - expf(-1.0f / (timeConst_s * sampleRate));
}

// ─── Software processing task ────────────────────────────────────────────────
//
// Pinned to Core 0 (same core as audioreactive's FFT task).
// Reads I2S audio blocks, runs all 7 biquad bandpass filters, applies a
// peak-hold envelope detector, log-compresses the result to 0..255, then
// writes into the shared volatile state variables above.

struct SWTaskParams {
  AudioSource  *source;       // I2S/ADC audio source (created by the usermod)
  float         Q;            // filter Q (stored for reference; coeffs pre-built)
  float         gainLevel;    // linear input gain (1.0 = unity)
  float         squelch;      // noise-gate threshold on the 0..255 output scale
  float         attackCoeff;  // one-pole coefficient for envelope attack
  float         decayCoeff;   // one-pole coefficient for envelope decay
  volatile bool stop;         // set true from the main task to request exit
};

static volatile TaskHandle_t s_swTaskHandle = nullptr;

static void IRAM_ATTR softwareProcessingTask(void *pvParams) {
  SWTaskParams *p = static_cast<SWTaskParams*>(pvParams);

  // Heap buffers — the 3 KB task stack is too small for two 128-float arrays.
  float *inputBuf    = static_cast<float*>(malloc(MSGEQ7_BLOCK_SIZE * sizeof(float)));
  float *filteredBuf = static_cast<float*>(malloc(MSGEQ7_BLOCK_SIZE * sizeof(float)));
  if (!inputBuf || !filteredBuf) {
    free(inputBuf);
    free(filteredBuf);
    s_swTaskHandle = nullptr;  // signal _stopProcessing() we exited before looping
    vTaskDelete(nullptr);
    return;
  }

  float envelope[NUM_BANDS] = {};
  float prevLowBandSum = 0.0f;
  float peakHoldTimer  = 0.0f;

  while (!p->stop) {
    delay(1);  // feeds IDLE(0) watchdog — do not remove; see audioreactive

    if (!p->source || !p->source->isInitialized()) {
      vTaskDelay(pdMS_TO_TICKS(1));
      continue;
    }

    // --- Fetch one block of audio samples from the I2S DMA ---
    p->source->getSamples(inputBuf, MSGEQ7_BLOCK_SIZE);

    // --- Apply input gain; compute block RMS and peak for volume output ---
    float blockPeak  = 0.0f;
    float blockSumSq = 0.0f;
    for (int i = 0; i < MSGEQ7_BLOCK_SIZE; i++) {
      inputBuf[i] *= p->gainLevel;
      float absVal = fabsf(inputBuf[i]);
      if (absVal > blockPeak) blockPeak = absVal;
      blockSumSq += absVal * absVal;
    }
    float blockRMS = sqrtf(blockSumSq / MSGEQ7_BLOCK_SIZE);

    // --- Run each biquad bandpass filter; update peak-hold envelope ---
    for (int b = 0; b < NUM_BANDS; b++) {
      // Select the best SIMD variant available at compile time.
#if dsps_biquad_f32_aes3_enabled
      dsps_biquad_f32_aes3(inputBuf, filteredBuf, MSGEQ7_BLOCK_SIZE,
                            s_filters[b].coeffs, s_filters[b].w);
#elif dsps_biquad_f32_ae32_enabled
      dsps_biquad_f32_ae32(inputBuf, filteredBuf, MSGEQ7_BLOCK_SIZE,
                            s_filters[b].coeffs, s_filters[b].w);
#else
      dsps_biquad_f32_ansi(inputBuf, filteredBuf, MSGEQ7_BLOCK_SIZE,
                            s_filters[b].coeffs, s_filters[b].w);
#endif

      // Peak-hold envelope: attack on rising signal, decay on falling.
      // Squelch is applied after compression on the 0..255 scale, not here.
      float attackC = p->attackCoeff;
      float decayC  = p->decayCoeff;
      float env     = envelope[b];
      for (int i = 0; i < MSGEQ7_BLOCK_SIZE; i++) {
        float absVal = fabsf(filteredBuf[i]);
        env += (absVal > env) ? (absVal - env) * attackC
                              : (absVal - env) * decayC;
      }
      envelope[b] = env;
    }

    // --- Log-compress envelopes to 0..255 ABSOLUTE scale ---
    //
    // The real MSGEQ7 chip outputs a voltage proportional to band amplitude —
    // quiet → small, loud → large. We normalise against the full int16 sample
    // range (a fixed reference, not the per-frame peak) so absolute amplitude
    // is preserved. This matches audioreactive's fftResult[] semantics, which
    // every WLED audio-reactive effect depends on.
    //
    // Curve: out = 255 * log10(1 + LOG_SCALE * (env/32768)) / log10(1 + LOG_SCALE)
    static constexpr float kFullScale  = 32768.0f;
    const float            kLogDivisor = log10f(1.0f + MSGEQ7_LOG_SCALE);
    float compressedEnv[NUM_BANDS];
    for (int b = 0; b < NUM_BANDS; b++) {
      float x = envelope[b] / kFullScale;
      if (x < 0.0f) x = 0.0f;
      if (x > 1.0f) x = 1.0f;
      float c = 255.0f * log10f(1.0f + MSGEQ7_LOG_SCALE * x) / kLogDivisor;
      if (c < p->squelch) c = 0.0f;  // noise gate on the user-visible scale
      compressedEnv[b] = c;
    }

    // --- Beat / samplePeak detection ---
    // Trigger on a fast rise in sub-bass energy (bands 0 + 1: 63 + 160 Hz).
    float lowBandSum = compressedEnv[0] + compressedEnv[1];
    if (lowBandSum - prevLowBandSum > MSGEQ7_PEAK_RISE_THRESHOLD * 255.0f
        && lowBandSum > p->squelch) {
      s_samplePeak  = 1;
      peakHoldTimer = 40.0f;  // hold ~40 iterations ≈ 1 frame at 25 fps
    }
    prevLowBandSum = lowBandSum;
    if (peakHoldTimer > 0.0f) {
      peakHoldTimer -= 1.0f;
      if (peakHoldTimer <= 0.0f) s_samplePeak = 0;
    }

    // --- FFT_MajorPeak: parabolic interpolation on the dominant band ---
    // Smooths the staircase artifact seen in FREQMAP/WATERFALL effects.
    int peakBand = 0;
    for (int b = 1; b < NUM_BANDS; b++) {
      if (compressedEnv[b] > compressedEnv[peakBand]) peakBand = b;
    }
    float majorPeak = MSGEQ7_FREQS_HZ[peakBand];
    if (peakBand > 0 && peakBand < NUM_BANDS - 1) {
      float a     = compressedEnv[peakBand - 1];
      float bval  = compressedEnv[peakBand];
      float c     = compressedEnv[peakBand + 1];
      float denom = a - 2.0f * bval + c;
      if (fabsf(denom) > 1e-6f) {
        // Fractional offset in log-frequency space, range [−0.5, +0.5].
        float offset    = 0.5f * (a - c) / denom;
        float logFreqLo = log10f(MSGEQ7_FREQS_HZ[peakBand - 1]);
        float logFreqPk = log10f(MSGEQ7_FREQS_HZ[peakBand]);
        float logFreqHi = log10f(MSGEQ7_FREQS_HZ[peakBand + 1]);
        float step = (offset >= 0.0f) ? (logFreqHi - logFreqPk)
                                      : (logFreqPk  - logFreqLo);
        majorPeak = powf(10.0f, logFreqPk + offset * step);
      }
    }
    if (majorPeak < 1.0f)                        majorPeak = 1.0f;
    if (majorPeak > MSGEQ7_SAMPLE_RATE / 2.0f)  majorPeak = MSGEQ7_SAMPLE_RATE / 2.0f;

    // --- my_magnitude: scaled dominant-band amplitude ---
    float magnitude = compressedEnv[peakBand] * p->gainLevel;
    if (magnitude < 0.001f) magnitude = 0.001f;

    // --- Volume: RMS-based smooth volume and block-peak raw volume ---
    float normRMS = blockRMS / 32768.0f * p->gainLevel;
    float volSmth = 255.0f * log10f(1.0f + MSGEQ7_LOG_SCALE * constrain(normRMS, 0.0f, 1.0f))
                           / log10f(1.0f + MSGEQ7_LOG_SCALE);
    uint16_t volRaw = (uint16_t)constrain(blockPeak * p->gainLevel / 128.0f, 0.0f, 65535.0f);

#ifdef SR_DEBUG
    DEBUGSR_PRINTF("MSGEQ7 bands: 0=%d 1=%d 2=%d 3=%d 4=%d 5=%d 6=%d\n",
      (int)compressedEnv[0], (int)compressedEnv[1], (int)compressedEnv[2],
      (int)compressedEnv[3], (int)compressedEnv[4], (int)compressedEnv[5],
      (int)compressedEnv[6]);
#endif

    // --- Publish to shared state (single writer, single reader) ---
    for (int b = 0; b < NUM_BANDS; b++) s_bandEnvelope[b] = compressedEnv[b];
    s_volumeSmth    = volSmth;
    s_volumeRaw     = volRaw;
    s_FFT_MajorPeak = majorPeak;
    s_my_magnitude  = magnitude;
    // s_samplePeak written above
  }

  free(inputBuf);
  free(filteredBuf);
  s_swTaskHandle = nullptr;  // signal _stopProcessing() that we have fully exited
  vTaskDelete(nullptr);
}

// ─── Hardware MSGEQ7 chip: GPIO protocol ─────────────────────────────────────
//
// The physical MSGEQ7 chip exposes 7 band amplitudes sequentially as an analog
// voltage on the OUT pin. A STROBE pulse advances the internal band multiplexer;
// a RESET pulse resets it back to band 0.
//
// Datasheet timings (MSI MSGEQ7):
//   Tss  (reset-to-strobe setup)  ≥ 72 µs
//   Tso  (strobe-to-output valid) ≤ 36 µs
//   Tsh  (strobe hold high)       ≥ 18 µs
//   Trh  (reset pulse width)      ≥ 100 ns
//   Trs  (reset-to-first-strobe)  ≥ 72 µs
//
// Reference: NicoHood MSGEQ7 library (https://github.com/NicoHood/MSGEQ7)

// Configure output GPIO pins for the STROBE and RESET lines.
// Call after PinManager::allocatePin() has reserved the pins.
static void msgeq7_hw_gpio_init(int8_t pinStrobe, int8_t pinReset) {
  pinMode(pinStrobe, OUTPUT);
  pinMode(pinReset,  OUTPUT);
  digitalWrite(pinStrobe, HIGH);  // STROBE idles high
  digitalWrite(pinReset,  LOW);   // RESET  idles low
}

// Read all 7 band amplitudes from the physical MSGEQ7 chip.
//
// pinStrobe, pinReset, pinOut: GPIO pin numbers (pinOut must be on ADC1).
// gainPercent : user gain setting (128 = unity gain).
// squelch     : noise-floor threshold on the 0..255 output scale.
// lastReadMs  : [in/out] timestamp of the most recent read for rate-limiting.
//
// Writes directly to s_bandEnvelope[] and the other shared state variables.
// Returns false if the call was skipped (MSGEQ7_HW_READ_INTERVAL_MS not elapsed).
static bool msgeq7_hw_read(int8_t pinStrobe, int8_t pinReset, int8_t pinOut,
                            uint8_t gainPercent, uint8_t squelch,
                            uint32_t &lastReadMs) {
  uint32_t now = millis();
  if (now - lastReadMs < MSGEQ7_HW_READ_INTERVAL_MS) return false;
  lastReadMs = now;

  float linearGain = gainPercent / 128.0f;
  float squelchF   = (float)squelch;
  float prevLow    = s_bandEnvelope[0] + s_bandEnvelope[1];

  // Pulse RESET high for ≥ 100 ns to reset the internal mux to band 0,
  // then wait Trs ≥ 72 µs for the first output to settle.
  digitalWrite(pinReset, HIGH);
  delayMicroseconds(1);   // well above the 100 ns minimum
  digitalWrite(pinReset, LOW);
  delayMicroseconds(72);  // Trs settling time

  for (int b = 0; b < NUM_BANDS; b++) {
    // Pull STROBE low; wait Tso for the output to settle; read ADC;
    // return STROBE high and wait Tsh before the next band.
    digitalWrite(pinStrobe, LOW);
    delayMicroseconds(36);                           // Tso ≤ 36 µs
    uint16_t adcVal = analogRead(pinOut);            // 12-bit, 0..4095
    digitalWrite(pinStrobe, HIGH);
    delayMicroseconds(36);                           // Tsh ≥ 18 µs

    // Map 12-bit ADC (0..4095) to 0..255 preserving full resolution,
    // then apply user gain. Avoids the 4-bit precision loss of >>4.
    float val = (adcVal * (255.0f / 4095.0f)) * linearGain;
    if (val < squelchF) val = 0.0f;
    if (val > 255.0f)   val = 255.0f;
    s_bandEnvelope[b] = val;
  }

  // --- Derive volumeSmth, volumeRaw, my_magnitude from band data ---
  // Hardware chip output is already log-compressed (analog voltage from chip).
  float envSum   = 0.0f;
  float envPeak  = 0.0f;
  int   peakBand = 0;
  for (int b = 0; b < NUM_BANDS; b++) {
    float v = s_bandEnvelope[b];
    envSum += v;
    if (v > envPeak) { envPeak = v; peakBand = b; }
  }
  s_volumeSmth   = envSum / (float)NUM_BANDS;
  s_volumeRaw    = (uint16_t)constrain(envPeak, 0.0f, 65535.0f);
  s_my_magnitude = (envPeak > 0.001f) ? envPeak : 0.001f;

  // --- FFT_MajorPeak: parabolic interpolation on the dominant band ---
  float majorPeak = MSGEQ7_FREQS_HZ[peakBand];
  if (peakBand > 0 && peakBand < NUM_BANDS - 1) {
    float a     = s_bandEnvelope[peakBand - 1];
    float bval  = s_bandEnvelope[peakBand];
    float c     = s_bandEnvelope[peakBand + 1];
    float denom = a - 2.0f * bval + c;
    if (fabsf(denom) > 1e-6f) {
      float offset    = 0.5f * (a - c) / denom;
      float logFreqLo = log10f(MSGEQ7_FREQS_HZ[peakBand - 1]);
      float logFreqPk = log10f(MSGEQ7_FREQS_HZ[peakBand]);
      float logFreqHi = log10f(MSGEQ7_FREQS_HZ[peakBand + 1]);
      float step = (offset >= 0.0f) ? (logFreqHi - logFreqPk)
                                    : (logFreqPk  - logFreqLo);
      majorPeak = powf(10.0f, logFreqPk + offset * step);
    }
  }
  if (majorPeak < 1.0f) majorPeak = 1.0f;
  s_FFT_MajorPeak = majorPeak;

  // --- Beat detection on low-band energy ---
  float lowSum = s_bandEnvelope[0] + s_bandEnvelope[1];
  s_samplePeak = ((lowSum - prevLow) > MSGEQ7_PEAK_RISE_THRESHOLD * 255.0f
                  && lowSum > squelchF) ? 1 : 0;

  return true;
}

// AI: end
