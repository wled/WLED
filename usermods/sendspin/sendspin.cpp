// AI: below section was generated by an AI
// This bridge reads WLED's shared ArduinoJson 6 document, so it must use WLED's integer layout.
#ifdef ARDUINOJSON_USE_LONG_LONG
#undef ARDUINOJSON_USE_LONG_LONG
#endif
#define ARDUINOJSON_USE_LONG_LONG 0

#include "wled.h"

#include <algorithm>
#include <atomic>

#include "sendspin_adapter.h"

namespace {

constexpr int16_t SENDSPIN_MIN_DB = -60;
constexpr int16_t SENDSPIN_MAX_DB = 0;
constexpr int16_t SENDSPIN_MIN_TRIM_DB = -24;
constexpr int16_t SENDSPIN_MAX_TRIM_DB = 24;

constexpr uint8_t scaleSendspin16To8(uint16_t value) {
  return static_cast<uint8_t>((static_cast<uint32_t>(value) + 128U) / 257U);
}

constexpr int32_t sendspinDbToLevel(int16_t db) {
  return (static_cast<int32_t>(db - SENDSPIN_MIN_DB) * UINT16_MAX + 30) / 60;
}

constexpr int32_t sendspinDbDeltaToLevel(int16_t db) {
  return db >= 0 ? (static_cast<int32_t>(db) * UINT16_MAX + 30) / 60
                 : (static_cast<int32_t>(db) * UINT16_MAX - 30) / 60;
}

// Gate the original dB level, then apply trim and map the selected dB window to WLED's range.
constexpr uint8_t mapSendspinSpectrum(uint16_t value, int16_t floorDb, int16_t ceilingDb,
                                     int16_t trimDb, int16_t inputGateDb) {
  if (value <= sendspinDbToLevel(inputGateDb)) return 0;
  const int32_t floorLevel = sendspinDbToLevel(floorDb);
  const int32_t ceilingLevel = sendspinDbToLevel(ceilingDb);
  const int32_t adjustedLevel = static_cast<int32_t>(value) + sendspinDbDeltaToLevel(trimDb);
  if (adjustedLevel <= floorLevel) return 0;
  if (adjustedLevel >= ceilingLevel) return UINT8_MAX;
  const int32_t range = ceilingLevel - floorLevel;
  return static_cast<uint8_t>(((adjustedLevel - floorLevel) * UINT8_MAX + range / 2) / range);
}

constexpr bool validSendspinSpectrumConfig(int32_t mapping, int32_t floorDb, int32_t ceilingDb,
                                           int32_t bassTrimDb, int32_t midTrimDb, int32_t trebleTrimDb,
                                           int32_t inputGateDb) {
  return mapping >= 0 && mapping <= 1 && floorDb >= SENDSPIN_MIN_DB && floorDb <= SENDSPIN_MAX_DB &&
         ceilingDb >= SENDSPIN_MIN_DB && ceilingDb <= SENDSPIN_MAX_DB && floorDb < ceilingDb &&
         inputGateDb >= SENDSPIN_MIN_DB && inputGateDb <= SENDSPIN_MAX_DB && inputGateDb < ceilingDb &&
         bassTrimDb >= SENDSPIN_MIN_TRIM_DB && bassTrimDb <= SENDSPIN_MAX_TRIM_DB &&
         midTrimDb >= SENDSPIN_MIN_TRIM_DB && midTrimDb <= SENDSPIN_MAX_TRIM_DB &&
         trebleTrimDb >= SENDSPIN_MIN_TRIM_DB && trebleTrimDb <= SENDSPIN_MAX_TRIM_DB;
}

uint32_t advanceCachedAge(uint32_t ageMs, uint32_t capturedMs, uint32_t now) {
  if (ageMs == UINT32_MAX) return UINT32_MAX;
  const uint32_t elapsed = now - capturedMs;
  return ageMs >= UINT32_MAX - elapsed ? UINT32_MAX - 1 : ageMs + elapsed;
}

static_assert(scaleSendspin16To8(0) == 0 && scaleSendspin16To8(UINT16_MAX) == UINT8_MAX,
              "Raw spectrum mapping must preserve protocol endpoints");
static_assert(scaleSendspin16To8(10336) == 40, "Raw spectrum mapping changed");
static_assert(mapSendspinSpectrum(0, -60, 0, 15, -60) == 0,
              "Pre-trim input gate must preserve exact silence");
static_assert(mapSendspinSpectrum(sendspinDbToLevel(-50), -60, 0, 0, -60) == 43,
              "Compatibility mapping must map the full dB window");
static_assert(mapSendspinSpectrum(sendspinDbToLevel(-50), -60, 0, 15, -60) == 106,
              "Compatibility mapping must apply positive dB trim");
static_assert(mapSendspinSpectrum(10336, -60, 0, 15, -60) == 104,
              "Compatibility mapping must preserve measured-sample calibration");
static_assert(mapSendspinSpectrum(sendspinDbToLevel(-10), -60, 0, 15, -60) == UINT8_MAX,
              "Compatibility mapping must clip high values");
static_assert(mapSendspinSpectrum(sendspinDbToLevel(-50), -60, 0, 15, -50) == 0,
              "Input gate must run before trim");
static_assert(mapSendspinSpectrum(sendspinDbToLevel(-50), -50, -10, 0, -60) == 0 &&
              mapSendspinSpectrum(sendspinDbToLevel(-10), -50, -10, 0, -60) == UINT8_MAX,
              "Compatibility mapping must preserve floor and ceiling boundaries");
static_assert(validSendspinSpectrumConfig(0, -60, 0, 0, 0, 0, -60),
              "Neutral Raw spectrum configuration must remain valid");
static_assert(!validSendspinSpectrumConfig(1, 0, 0, 0, 0, 0, -60) &&
              !validSendspinSpectrumConfig(1, -60, 0, 25, 0, 0, -60) &&
              !validSendspinSpectrumConfig(1, -60, 0, 0, 0, 0, 0),
              "Invalid compatibility parameter combinations must be rejected");

}  // namespace

class SendspinUsermod final : public Usermod {
private:
  enum class State : uint8_t {
    Disabled,
    WaitingForNetwork,
    Starting,
    Connecting,
    Connected,
    Streaming,
    RetryBackoff,
    StoppingForOta,
    Error,
  };

  enum class PeakSource : uint8_t {
    Both,
    Beat,
    Transient,
  };

  enum class SpectrumMapping : uint8_t {
    Raw,
    WledCompatibility,
  };

  enum class ConfigError : uint8_t {
    None,
    ConfigObject,
    Enabled,
    AllowUnpaired,
    DisplayOffset,
    PeakSource,
    SpectrumMapping,
    SpectrumFloor,
    SpectrumCeiling,
    SpectrumBassTrim,
    SpectrumMidTrim,
    SpectrumTrebleTrim,
    SpectrumInputGate,
    SpectrumCombination,
    Url,
    DeviceName,
  };

  struct SpectrumConfig {
    SpectrumMapping mapping{SpectrumMapping::Raw};
    int16_t floorDb{SENDSPIN_MIN_DB};
    int16_t ceilingDb{SENDSPIN_MAX_DB};
    int16_t bassTrimDb{0};
    int16_t midTrimDb{0};
    int16_t trebleTrimDb{0};
    int16_t inputGateDb{SENDSPIN_MIN_DB};
  };

  struct DiagnosticsSnapshot {
    SendspinAdapterStatus adapterStatus{};
    uint32_t adapterStatusCapturedMs{0};
    uint32_t connectAttempts{0};
    uint32_t lastConnectAttemptMs{0};
    uint32_t lastBeatMs{0};
    uint32_t lastDownbeatMs{0};
    uint32_t lastTransientMs{0};
    uint32_t lastSpectrumAppliedMs{0};
    uint32_t lastProviderReadMs{0};
    uint32_t spectrumAppliedCount{0};
    uint32_t providerReadCount{0};
    uint32_t spectrumStaleTransitions{0};
    uint32_t band0Average{0};
    uint16_t loudnessInput{0};
    uint16_t spectrumInput[16]{};
    uint16_t band0AboveThreshold{0};
    uint16_t band0SampleCount{0};
    int16_t volumeRaw{0};
    float volumeSmoothed{0.0f};
    uint8_t spectrum[16]{};
    uint8_t providerSpectrum[16]{};
    uint8_t lastPeakStrength{0};
    uint8_t band0Minimum{0};
    uint8_t band0Maximum{0};
    bool adapterAvailable{false};
  };

  static constexpr size_t URL_CAPACITY = 192;
  static constexpr size_t NAME_CAPACITY = 33;
  static constexpr uint32_t STALE_FRAME_MS = 500;
  static constexpr uint32_t PEAK_HOLD_MS = 50;
  static constexpr uint32_t VOLUME_ATTACK_MS = 80;
  static constexpr uint32_t VOLUME_DECAY_MS = 1400;
  static constexpr uint32_t VOLUME_BIG_CHANGE = 196;
  static constexpr uint32_t INITIAL_RETRY_MS = 60000;
  static constexpr uint32_t MAX_RETRY_MS = 300000;
  static constexpr uint32_t BAND0_WINDOW_MS = 10000;
  static constexpr size_t BAND0_SAMPLE_CAPACITY = 320;

  static const char _name[];
  static const char _enabled[];
  static const char _url[];
  static const char _deviceName[];
  static const char _displayOffset[];
  static const char _allowUnpaired[];
  static const char _peakSource[];
  static const char _spectrumMapping[];
  static const char _spectrumFloor[];
  static const char _spectrumCeiling[];
  static const char _spectrumBassTrim[];
  static const char _spectrumMidTrim[];
  static const char _spectrumTrebleTrim[];
  static const char _spectrumInputGate[];

  bool enabled_{false};
  bool allowUnpaired_{false};
  bool initDone_{false};
  bool configDirty_{false};
  bool otaActive_{false};
  bool wasConnected_{false};
  ConfigError configError_{ConfigError::None};
  char url_[URL_CAPACITY]{};
  char deviceName_[NAME_CAPACITY]{};
  int32_t displayOffsetMs_{0};
  int32_t lastRequestedOffsetMs_{0};
  PeakSource peakSource_{PeakSource::Transient};
  std::atomic<SpectrumMapping> spectrumMapping_{SpectrumMapping::Raw};
  std::atomic<int16_t> spectrumFloorDb_{SENDSPIN_MIN_DB};
  std::atomic<int16_t> spectrumCeilingDb_{SENDSPIN_MAX_DB};
  std::atomic<int16_t> spectrumBassTrimDb_{0};
  std::atomic<int16_t> spectrumMidTrimDb_{0};
  std::atomic<int16_t> spectrumTrebleTrimDb_{0};
  std::atomic<int16_t> spectrumInputGateDb_{SENDSPIN_MIN_DB};
  std::atomic<uint32_t> spectrumConfigVersion_{0};
  SpectrumConfig runtimeSpectrumConfig_{};

  SendspinAdapter* adapter_{nullptr};
  SemaphoreHandle_t diagnosticsMutex_{nullptr};
  SendspinAdapterStatus adapterStatus_{};
  uint32_t adapterStatusCapturedMs_{0};
  std::atomic<State> state_{State::Disabled};
  std::atomic<bool> adapterStatusAvailable_{false};
  std::atomic<bool> diagnosticsValid_{false};
  uint32_t nextRetryMs_{0};
  uint32_t retryDelayMs_{INITIAL_RETRY_MS};
  uint32_t lastLiveFrameMs_{0};
  uint32_t peakUntilMs_{0};
  uint32_t connectAttempts_{0};
  uint32_t lastConnectAttemptMs_{0};
  uint32_t configReadCount_{0};
  uint32_t lastVolumeUpdateMs_{0};
  uint32_t lastBeatMs_{0};
  uint32_t lastDownbeatMs_{0};
  uint32_t lastTransientMs_{0};
  uint32_t lastSpectrumAppliedMs_{0};
  uint32_t lastProviderReadMs_{0};
  uint32_t spectrumAppliedCount_{0};
  uint32_t providerReadCount_{0};
  uint32_t spectrumStaleTransitions_{0};
  uint16_t loudnessInput_{0};
  uint16_t spectrumInput_[16]{};
  float volumeSmoothed_{0.0f};
  int16_t volumeRaw_{0};
  uint8_t spectrum_[16]{};
  float diagnosticVolumeSmoothed_{0.0f};
  int16_t diagnosticVolumeRaw_{0};
  uint8_t diagnosticSpectrum_[16]{};
  uint8_t providerSpectrum_[16]{};
  uint32_t band0SampleTimes_[BAND0_SAMPLE_CAPACITY]{};
  uint8_t band0Samples_[BAND0_SAMPLE_CAPACITY]{};
  uint16_t band0SampleHead_{0};
  uint16_t band0SampleCount_{0};
  uint8_t lastPeakStrength_{0};
  bool samplePeak_{false};
  bool spectrumWasStale_{false};
  float dominantFrequency_{1.0f};
  float dominantMagnitude_{0.0f};
  uint8_t maxVolume_{31};
  uint8_t selectedBin_{8};

  bool lockDiagnostics(TickType_t waitTicks) const {
    return diagnosticsMutex_ != nullptr && xSemaphoreTake(diagnosticsMutex_, waitTicks) == pdTRUE;
  }

  void unlockDiagnostics() const {
    xSemaphoreGive(diagnosticsMutex_);
  }

  static bool validUrl(const char* value) {
    if (value == nullptr || value[0] == '\0') return true;
    const size_t len = strnlen(value, URL_CAPACITY);
    if (len == 0 || len >= URL_CAPACITY) return false;
    if (strncmp(value, "ws://", 5) != 0 && strncmp(value, "wss://", 6) != 0) return false;
    if (memchr(value, '@', len) != nullptr || memchr(value, '?', len) != nullptr || memchr(value, '#', len) != nullptr) return false;
    for (size_t i = 0; i < len; i++) {
      const uint8_t c = static_cast<uint8_t>(value[i]);
      if (c <= 0x20 || c >= 0x7f) return false;
    }
    const char* host = value + (value[2] == 's' ? 6 : 5);
    return host[0] != '\0' && host[0] != '/';
  }

  static bool validName(const char* value) {
    if (value == nullptr) return false;
    const size_t len = strnlen(value, NAME_CAPACITY);
    if (len >= NAME_CAPACITY) return false;
    for (size_t i = 0; i < len; i++) {
      const uint8_t c = static_cast<uint8_t>(value[i]);
      if (c < 0x20 || c >= 0x7f || c == '<' || c == '>' || c == '&') return false;
    }
    return true;
  }

  static uint8_t mapSpectrum(uint16_t value, size_t band, const SpectrumConfig& config) {
    if (config.mapping == SpectrumMapping::Raw) return scaleSendspin16To8(value);
    const int16_t trimDb = band < 4 ? config.bassTrimDb : band < 12 ? config.midTrimDb : config.trebleTrimDb;
    return mapSendspinSpectrum(value, config.floorDb, config.ceilingDb, trimDb, config.inputGateDb);
  }

  SpectrumConfig currentSpectrumConfig() {
    const uint32_t version = spectrumConfigVersion_.load(std::memory_order_acquire);
    if ((version & 1U) != 0) return runtimeSpectrumConfig_;
    const SpectrumConfig candidate{
      .mapping = spectrumMapping_.load(std::memory_order_relaxed),
      .floorDb = spectrumFloorDb_.load(std::memory_order_relaxed),
      .ceilingDb = spectrumCeilingDb_.load(std::memory_order_relaxed),
      .bassTrimDb = spectrumBassTrimDb_.load(std::memory_order_relaxed),
      .midTrimDb = spectrumMidTrimDb_.load(std::memory_order_relaxed),
      .trebleTrimDb = spectrumTrebleTrimDb_.load(std::memory_order_relaxed),
      .inputGateDb = spectrumInputGateDb_.load(std::memory_order_relaxed),
    };
    std::atomic_thread_fence(std::memory_order_acquire);
    if (spectrumConfigVersion_.load(std::memory_order_relaxed) == version) runtimeSpectrumConfig_ = candidate;
    return runtimeSpectrumConfig_;
  }

  uint8_t peakEventMask() const {
    switch (peakSource_) {
      case PeakSource::Beat: return SENDSPIN_EVENT_BEAT;
      case PeakSource::Transient: return SENDSPIN_EVENT_TRANSIENT;
      default: return SENDSPIN_EVENT_BEAT | SENDSPIN_EVENT_TRANSIENT;
    }
  }

  // Keep only mapped band-0 samples from the preceding ten seconds.
  void pruneBand0Samples(uint32_t now) {
    while (band0SampleCount_ > 0 && now - band0SampleTimes_[band0SampleHead_] > BAND0_WINDOW_MS) {
      band0SampleHead_ = (band0SampleHead_ + 1) % BAND0_SAMPLE_CAPACITY;
      band0SampleCount_--;
    }
  }

  // Record one applied sample in a fixed ring so diagnostics cannot grow at runtime.
  void recordBand0Sample(uint8_t value, uint32_t now) {
    pruneBand0Samples(now);
    if (band0SampleCount_ == BAND0_SAMPLE_CAPACITY) {
      band0SampleHead_ = (band0SampleHead_ + 1) % BAND0_SAMPLE_CAPACITY;
      band0SampleCount_--;
    }
    const size_t index = (band0SampleHead_ + band0SampleCount_) % BAND0_SAMPLE_CAPACITY;
    band0SampleTimes_[index] = now;
    band0Samples_[index] = value;
    band0SampleCount_++;
  }

  // Start producer/consumer counters together for each adapter session.
  void resetSpectrumDiagnostics() {
    const bool locked = lockDiagnostics(pdMS_TO_TICKS(5));
    if (diagnosticsMutex_ != nullptr && !locked) {
      diagnosticsValid_.store(false, std::memory_order_release);
      return;
    }
    lastSpectrumAppliedMs_ = 0;
    lastProviderReadMs_ = 0;
    spectrumAppliedCount_ = 0;
    providerReadCount_ = 0;
    spectrumStaleTransitions_ = 0;
    memset(providerSpectrum_, 0, sizeof(providerSpectrum_));
    band0SampleHead_ = 0;
    band0SampleCount_ = 0;
    spectrumWasStale_ = false;
    diagnosticsValid_.store(true, std::memory_order_release);
    if (locked) unlockDiagnostics();
  }

  // Count each transition into an applied-spectrum stale state while streaming.
  void updateSpectrumFreshness(bool streamActive, uint32_t now) {
    const bool locked = lockDiagnostics(pdMS_TO_TICKS(2));
    if (diagnosticsMutex_ != nullptr && !locked) {
      diagnosticsValid_.store(false, std::memory_order_release);
      return;
    }
    if (!streamActive || lastSpectrumAppliedMs_ == 0) {
      if (!streamActive) lastSpectrumAppliedMs_ = 0;
      spectrumWasStale_ = false;
      if (locked) unlockDiagnostics();
      return;
    }
    const bool stale = now - lastSpectrumAppliedMs_ > STALE_FRAME_MS;
    if (stale && !spectrumWasStale_) spectrumStaleTransitions_++;
    spectrumWasStale_ = stale;
    if (locked) unlockDiagnostics();
  }

  // Apply AudioReactive::limitSampleDynamics() slew-rate math without microphone gain or AGC.
  void updateVolumeSmoothed(uint32_t now) {
    if (lastVolumeUpdateMs_ == 0) {
      lastVolumeUpdateMs_ = now;
    } else {
      uint32_t elapsed = now - lastVolumeUpdateMs_;
      if (elapsed > 0) {
        lastVolumeUpdateMs_ = now;
        elapsed = std::min<uint32_t>(elapsed, 1000);

        float delta = static_cast<float>(volumeRaw_) - volumeSmoothed_;
        const float limit = VOLUME_BIG_CHANGE * static_cast<float>(elapsed) /
                            static_cast<float>(delta >= 0.0f ? VOLUME_ATTACK_MS : VOLUME_DECAY_MS);
        if (delta > limit) delta = limit;
        else if (delta < -limit) delta = -limit;
        volumeSmoothed_ += delta;
      }
    }
    const bool locked = lockDiagnostics(pdMS_TO_TICKS(2));
    if (locked) {
      diagnosticVolumeSmoothed_ = volumeSmoothed_;
      unlockDiagnostics();
    } else if (diagnosticsMutex_ != nullptr) diagnosticsValid_.store(false, std::memory_order_release);
  }

  const char* effectiveName() const {
    return deviceName_[0] != '\0' ? deviceName_ : serverDescription;
  }

  void clearAudio() {
    volumeSmoothed_ = 0.0f;
    volumeRaw_ = 0;
    memset(spectrum_, 0, sizeof(spectrum_));
    samplePeak_ = false;
    dominantFrequency_ = 1.0f;
    dominantMagnitude_ = 0.0f;
    peakUntilMs_ = 0;
    lastVolumeUpdateMs_ = 0;
    lastLiveFrameMs_ = 0;
    const bool locked = lockDiagnostics(pdMS_TO_TICKS(5));
    if (!locked) {
      diagnosticsValid_.store(false, std::memory_order_release);
      return;
    }
    loudnessInput_ = 0;
    memset(spectrumInput_, 0, sizeof(spectrumInput_));
    diagnosticVolumeSmoothed_ = 0.0f;
    diagnosticVolumeRaw_ = 0;
    memset(diagnosticSpectrum_, 0, sizeof(diagnosticSpectrum_));
    lastPeakStrength_ = 0;
    lastBeatMs_ = 0;
    lastDownbeatMs_ = 0;
    lastTransientMs_ = 0;
    lastSpectrumAppliedMs_ = 0;
    lastProviderReadMs_ = 0;
    memset(providerSpectrum_, 0, sizeof(providerSpectrum_));
    band0SampleHead_ = 0;
    band0SampleCount_ = 0;
    spectrumWasStale_ = false;
    unlockDiagnostics();
  }

  void stopAdapter() {
    if (adapter_ != nullptr) {
      sendspinAdapterDestroy(adapter_);
      adapter_ = nullptr;
    }
    wasConnected_ = false;
    retryDelayMs_ = INITIAL_RETRY_MS;
    nextRetryMs_ = 0;
    adapterStatusAvailable_.store(false, std::memory_order_release);
    const bool locked = lockDiagnostics(pdMS_TO_TICKS(5));
    if (diagnosticsMutex_ == nullptr || locked) {
      adapterStatus_ = {};
      adapterStatusCapturedMs_ = 0;
      if (locked) unlockDiagnostics();
    }
    clearAudio();
  }

  bool startAdapter() {
    resetSpectrumDiagnostics();
    SendspinAdapterConfig config{
      .name = effectiveName(),
      .displayOffsetMs = displayOffsetMs_,
      .allowUnpaired = allowUnpaired_,
      .restoreWifiSleep = !noWifiSleep,
    };
    adapter_ = sendspinAdapterCreate(config);
    if (adapter_ == nullptr || !sendspinAdapterStart(adapter_)) {
      stopAdapter();
      return false;
    }
    retryDelayMs_ = INITIAL_RETRY_MS;
    nextRetryMs_ = 0;
    return true;
  }

  void applyFrame(const SendspinAdapterFrame& frame, uint32_t now) {
    if (frame.clear || !frame.streamActive) {
      clearAudio();
      return;
    }

    const SpectrumConfig spectrumConfig = currentSpectrumConfig();
    volumeRaw_ = scaleSendspin16To8(frame.loudness);
    for (size_t i = 0; i < 16; i++) {
      spectrum_[i] = mapSpectrum(frame.spectrum[i], i, spectrumConfig);
    }
    dominantFrequency_ = frame.peakFrequency == 0 ? 1.0f : constrain(static_cast<float>(frame.peakFrequency), 1.0f, 11025.0f);
    dominantMagnitude_ = static_cast<float>(frame.peakAmplitude) / 64.0f;
    if ((frame.events & peakEventMask()) != 0) peakUntilMs_ = now + std::max<uint32_t>(PEAK_HOLD_MS, strip.getFrameTime());
    samplePeak_ = static_cast<int32_t>(peakUntilMs_ - now) > 0;
    lastLiveFrameMs_ = now;

    const bool locked = lockDiagnostics(pdMS_TO_TICKS(5));
    if (!locked) {
      diagnosticsValid_.store(false, std::memory_order_release);
      return;
    }
    loudnessInput_ = frame.loudness;
    diagnosticVolumeRaw_ = volumeRaw_;
    memcpy(spectrumInput_, frame.spectrum, sizeof(spectrumInput_));
    memcpy(diagnosticSpectrum_, spectrum_, sizeof(diagnosticSpectrum_));
    if (frame.spectrumUpdated) {
      lastSpectrumAppliedMs_ = now;
      spectrumAppliedCount_++;
      recordBand0Sample(spectrum_[0], now);
    }
    if ((frame.events & SENDSPIN_EVENT_BEAT) != 0) lastBeatMs_ = now;
    if ((frame.events & SENDSPIN_EVENT_DOWNBEAT) != 0) lastDownbeatMs_ = now;
    if ((frame.events & SENDSPIN_EVENT_TRANSIENT) != 0) {
      lastTransientMs_ = now;
      lastPeakStrength_ = frame.peakStrength;
    }
    unlockDiagnostics();
  }

  // Copy bounded diagnostic state so JSON rendering never holds the diagnostics mutex.
  bool captureDiagnostics(DiagnosticsSnapshot& snapshot, uint32_t now) {
    if (!diagnosticsValid_.load(std::memory_order_acquire)) return false;
    if (!lockDiagnostics(pdMS_TO_TICKS(5))) return false;
    if (!diagnosticsValid_.load(std::memory_order_acquire)) {
      unlockDiagnostics();
      return false;
    }
    pruneBand0Samples(now);
    snapshot.adapterStatus = adapterStatus_;
    snapshot.adapterStatusCapturedMs = adapterStatusCapturedMs_;
    snapshot.adapterAvailable = adapterStatusAvailable_.load(std::memory_order_acquire);
    snapshot.connectAttempts = connectAttempts_;
    snapshot.lastConnectAttemptMs = lastConnectAttemptMs_;
    snapshot.lastBeatMs = lastBeatMs_;
    snapshot.lastDownbeatMs = lastDownbeatMs_;
    snapshot.lastTransientMs = lastTransientMs_;
    snapshot.lastSpectrumAppliedMs = lastSpectrumAppliedMs_;
    snapshot.lastProviderReadMs = lastProviderReadMs_;
    snapshot.spectrumAppliedCount = spectrumAppliedCount_;
    snapshot.providerReadCount = providerReadCount_;
    snapshot.spectrumStaleTransitions = spectrumStaleTransitions_;
    snapshot.loudnessInput = loudnessInput_;
    snapshot.volumeRaw = diagnosticVolumeRaw_;
    snapshot.volumeSmoothed = diagnosticVolumeSmoothed_;
    snapshot.lastPeakStrength = lastPeakStrength_;
    memcpy(snapshot.spectrumInput, spectrumInput_, sizeof(snapshot.spectrumInput));
    memcpy(snapshot.spectrum, diagnosticSpectrum_, sizeof(snapshot.spectrum));
    memcpy(snapshot.providerSpectrum, providerSpectrum_, sizeof(snapshot.providerSpectrum));
    snapshot.band0SampleCount = band0SampleCount_;
    if (band0SampleCount_ > 0) {
      uint32_t sum = 0;
      snapshot.band0Minimum = UINT8_MAX;
      for (size_t i = 0; i < band0SampleCount_; i++) {
        const uint8_t value = band0Samples_[(band0SampleHead_ + i) % BAND0_SAMPLE_CAPACITY];
        sum += value;
        snapshot.band0Minimum = std::min(snapshot.band0Minimum, value);
        snapshot.band0Maximum = std::max(snapshot.band0Maximum, value);
        if (value > 128) snapshot.band0AboveThreshold++;
      }
      snapshot.band0Average = sum / band0SampleCount_;
    }
    unlockDiagnostics();
    return diagnosticsValid_.load(std::memory_order_acquire);
  }

  static const char* stateName(State state) {
    switch (state) {
      case State::Disabled: return "disabled";
      case State::WaitingForNetwork: return "waiting for network";
      case State::Starting: return "starting";
      case State::Connecting: return "connecting";
      case State::Connected: return "connected";
      case State::Streaming: return "streaming";
      case State::RetryBackoff: return "retrying";
      case State::StoppingForOta: return "stopped for OTA";
      default: return "error";
    }
  }

  static const char* configErrorName(ConfigError error) {
    switch (error) {
      case ConfigError::ConfigObject: return "Sendspin object";
      case ConfigError::Enabled: return "enabled";
      case ConfigError::AllowUnpaired: return "allow-unpaired";
      case ConfigError::DisplayOffset: return "display-offset-ms";
      case ConfigError::PeakSource: return "peak-source";
      case ConfigError::SpectrumMapping: return "spectrum-mapping";
      case ConfigError::SpectrumFloor: return "spectrum-floor-db";
      case ConfigError::SpectrumCeiling: return "spectrum-ceiling-db";
      case ConfigError::SpectrumBassTrim: return "spectrum-bass-trim-db";
      case ConfigError::SpectrumMidTrim: return "spectrum-mid-trim-db";
      case ConfigError::SpectrumTrebleTrim: return "spectrum-treble-trim-db";
      case ConfigError::SpectrumInputGate: return "spectrum-input-gate-db";
      case ConfigError::SpectrumCombination: return "spectrum parameter combination";
      case ConfigError::Url: return "url";
      case ConfigError::DeviceName: return "device-name";
      default: return "unknown";
    }
  }

  void rejectConfig(ConfigError error, bool& valid) {
    if (configError_ == ConfigError::None) configError_ = error;
    valid = false;
  }

public:
  ~SendspinUsermod() override {
    stopAdapter();
    if (diagnosticsMutex_ != nullptr) vSemaphoreDelete(diagnosticsMutex_);
  }

  void setup() override {
    diagnosticsMutex_ = xSemaphoreCreateMutex();
    um_data = new um_data_t;
    um_data->u_size = 8;
    um_data->u_type = new um_types_t[um_data->u_size];
    um_data->u_data = new void*[um_data->u_size];
    um_data->u_data[0] = &volumeSmoothed_;
    um_data->u_type[0] = UMT_FLOAT;
    um_data->u_data[1] = &volumeRaw_;
    um_data->u_type[1] = UMT_UINT16;
    um_data->u_data[2] = spectrum_;
    um_data->u_type[2] = UMT_BYTE_ARR;
    um_data->u_data[3] = &samplePeak_;
    um_data->u_type[3] = UMT_BYTE;
    um_data->u_data[4] = &dominantFrequency_;
    um_data->u_type[4] = UMT_FLOAT;
    um_data->u_data[5] = &dominantMagnitude_;
    um_data->u_type[5] = UMT_FLOAT;
    um_data->u_data[6] = &maxVolume_;
    um_data->u_type[6] = UMT_BYTE;
    um_data->u_data[7] = &selectedBin_;
    um_data->u_type[7] = UMT_BYTE;
    clearAudio();
    initDone_ = true;
    state_ = enabled_ ? State::WaitingForNetwork : State::Disabled;
  }

  void loop() override {
    const uint32_t now = millis();
    if (otaActive_) return;

    if (!enabled_) {
      if (adapter_ != nullptr) stopAdapter();
      state_ = State::Disabled;
      return;
    }

    if (!WLED_CONNECTED) {
      if (adapter_ != nullptr) stopAdapter();
      state_ = State::WaitingForNetwork;
      return;
    }

    if (configDirty_) {
      stopAdapter();
      configDirty_ = false;
    }

    if (adapter_ == nullptr) {
      if (nextRetryMs_ != 0 && static_cast<int32_t>(now - nextRetryMs_) < 0) {
        state_ = State::RetryBackoff;
        return;
      }
      state_ = State::Starting;
      if (!startAdapter()) {
        state_ = State::Error;
        nextRetryMs_ = now + INITIAL_RETRY_MS;
        return;
      }
    }

    sendspinAdapterLoop(adapter_, true);
    SendspinAdapterStatus status{};
    sendspinAdapterGetStatus(adapter_, status);
    const uint32_t statusCapturedMs = millis();
    const bool statusLocked = lockDiagnostics(pdMS_TO_TICKS(2));
    if (diagnosticsMutex_ == nullptr || statusLocked) {
      adapterStatus_ = status;
      adapterStatusCapturedMs_ = statusCapturedMs;
      adapterStatusAvailable_.store(true, std::memory_order_release);
      if (statusLocked) unlockDiagnostics();
    } else diagnosticsValid_.store(false, std::memory_order_release);

    if (status.connected) {
      wasConnected_ = true;
      retryDelayMs_ = INITIAL_RETRY_MS;
      nextRetryMs_ = 0;
      state_ = status.streamActive ? State::Streaming : State::Connected;
    } else {
      state_ = State::Connecting;
      if (wasConnected_) {
        wasConnected_ = false;
        clearAudio();
        nextRetryMs_ = now + 5000;
      }

      if (url_[0] != '\0' && (nextRetryMs_ == 0 || static_cast<int32_t>(now - nextRetryMs_) >= 0)) {
        const bool attemptsLocked = lockDiagnostics(pdMS_TO_TICKS(2));
        if (diagnosticsMutex_ == nullptr || attemptsLocked) {
          connectAttempts_++;
          lastConnectAttemptMs_ = now;
          if (attemptsLocked) unlockDiagnostics();
        } else diagnosticsValid_.store(false, std::memory_order_release);
        sendspinAdapterConnect(adapter_, url_);
        nextRetryMs_ = now + retryDelayMs_;
        retryDelayMs_ = std::min<uint32_t>(retryDelayMs_ * 2U, MAX_RETRY_MS);
      } else if (url_[0] != '\0') {
        state_ = State::RetryBackoff;
      }
    }

    SendspinAdapterFrame frame{};
    if (sendspinAdapterTakeFrame(adapter_, frame)) applyFrame(frame, now);
    updateSpectrumFreshness(status.streamActive, now);
    updateVolumeSmoothed(now);
    if (lastLiveFrameMs_ != 0 && now - lastLiveFrameMs_ > STALE_FRAME_MS) clearAudio();
    if (samplePeak_ && static_cast<int32_t>(now - peakUntilMs_) >= 0) samplePeak_ = false;
  }

  bool getUMData(um_data_t** data) override {
    if (data == nullptr || !enabled_ || um_data == nullptr) return false;
    const bool locked = lockDiagnostics(pdMS_TO_TICKS(2));
    if (diagnosticsMutex_ == nullptr || locked) {
      memcpy(providerSpectrum_, spectrum_, sizeof(providerSpectrum_));
      providerReadCount_++;
      lastProviderReadMs_ = millis();
      if (locked) unlockDiagnostics();
    } else diagnosticsValid_.store(false, std::memory_order_release);
    *data = um_data;
    return true;
  }

  uint16_t getId() override { return USERMOD_ID_AUDIOREACTIVE; }

  void onUpdateBegin(bool init) override {
    otaActive_ = init;
    if (init) {
      state_ = State::StoppingForOta;
      stopAdapter();
    } else {
      configDirty_ = true;
      state_ = enabled_ ? State::WaitingForNetwork : State::Disabled;
    }
  }

  void addToConfig(JsonObject& root) override {
    JsonObject top = root.createNestedObject(FPSTR(_name));
    top[FPSTR(_enabled)] = enabled_;
    top[FPSTR(_url)] = url_;
    top[FPSTR(_deviceName)] = deviceName_;
    top[FPSTR(_displayOffset)] = displayOffsetMs_;
    top[FPSTR(_allowUnpaired)] = allowUnpaired_;
    top[FPSTR(_peakSource)] = static_cast<uint8_t>(peakSource_);
    top[FPSTR(_spectrumMapping)] = static_cast<uint8_t>(spectrumMapping_.load(std::memory_order_relaxed));
    top[FPSTR(_spectrumFloor)] = spectrumFloorDb_.load(std::memory_order_relaxed);
    top[FPSTR(_spectrumCeiling)] = spectrumCeilingDb_.load(std::memory_order_relaxed);
    top[FPSTR(_spectrumBassTrim)] = spectrumBassTrimDb_.load(std::memory_order_relaxed);
    top[FPSTR(_spectrumMidTrim)] = spectrumMidTrimDb_.load(std::memory_order_relaxed);
    top[FPSTR(_spectrumTrebleTrim)] = spectrumTrebleTrimDb_.load(std::memory_order_relaxed);
    top[FPSTR(_spectrumInputGate)] = spectrumInputGateDb_.load(std::memory_order_relaxed);
  }

  bool readFromConfig(JsonObject& root) override {
    configReadCount_++;
    configError_ = ConfigError::None;
    if (!root.containsKey(FPSTR(_name))) return false;
    if (!root[FPSTR(_name)].is<JsonObject>()) {
      configError_ = ConfigError::ConfigObject;
      return true;
    }
    JsonObject top = root[FPSTR(_name)];
    bool requestedEnabled = enabled_;
    bool requestedAllowUnpaired = allowUnpaired_;
    int32_t requestedOffset = displayOffsetMs_;
    int32_t requestedPeakSource = static_cast<uint8_t>(peakSource_);
    int32_t requestedSpectrumMapping = static_cast<uint8_t>(spectrumMapping_.load(std::memory_order_relaxed));
    int32_t requestedSpectrumFloor = spectrumFloorDb_.load(std::memory_order_relaxed);
    int32_t requestedSpectrumCeiling = spectrumCeilingDb_.load(std::memory_order_relaxed);
    int32_t requestedSpectrumBassTrim = spectrumBassTrimDb_.load(std::memory_order_relaxed);
    int32_t requestedSpectrumMidTrim = spectrumMidTrimDb_.load(std::memory_order_relaxed);
    int32_t requestedSpectrumTrebleTrim = spectrumTrebleTrimDb_.load(std::memory_order_relaxed);
    int32_t requestedSpectrumInputGate = spectrumInputGateDb_.load(std::memory_order_relaxed);
    char requestedUrl[URL_CAPACITY];
    char requestedName[NAME_CAPACITY];
    strlcpy(requestedUrl, url_, sizeof(requestedUrl));
    strlcpy(requestedName, deviceName_, sizeof(requestedName));

    bool valid = true;
    if (!getJsonValue(top[FPSTR(_enabled)], requestedEnabled)) rejectConfig(ConfigError::Enabled, valid);
    if (!getJsonValue(top[FPSTR(_allowUnpaired)], requestedAllowUnpaired)) rejectConfig(ConfigError::AllowUnpaired, valid);
    if (!getJsonValue(top[FPSTR(_displayOffset)], requestedOffset)) rejectConfig(ConfigError::DisplayOffset, valid);
    lastRequestedOffsetMs_ = requestedOffset;
    if (!getJsonValue(top[FPSTR(_peakSource)], requestedPeakSource) ||
        requestedPeakSource < static_cast<uint8_t>(PeakSource::Both) ||
        requestedPeakSource > static_cast<uint8_t>(PeakSource::Transient)) {
      rejectConfig(ConfigError::PeakSource, valid);
    }
    if (!getJsonValue(top[FPSTR(_spectrumMapping)], requestedSpectrumMapping)) rejectConfig(ConfigError::SpectrumMapping, valid);
    if (!getJsonValue(top[FPSTR(_spectrumFloor)], requestedSpectrumFloor)) rejectConfig(ConfigError::SpectrumFloor, valid);
    if (!getJsonValue(top[FPSTR(_spectrumCeiling)], requestedSpectrumCeiling)) rejectConfig(ConfigError::SpectrumCeiling, valid);
    if (!getJsonValue(top[FPSTR(_spectrumBassTrim)], requestedSpectrumBassTrim)) rejectConfig(ConfigError::SpectrumBassTrim, valid);
    if (!getJsonValue(top[FPSTR(_spectrumMidTrim)], requestedSpectrumMidTrim)) rejectConfig(ConfigError::SpectrumMidTrim, valid);
    if (!getJsonValue(top[FPSTR(_spectrumTrebleTrim)], requestedSpectrumTrebleTrim)) rejectConfig(ConfigError::SpectrumTrebleTrim, valid);
    if (!getJsonValue(top[FPSTR(_spectrumInputGate)], requestedSpectrumInputGate)) rejectConfig(ConfigError::SpectrumInputGate, valid);
    if (top[FPSTR(_url)].is<const char*>() && validUrl(top[FPSTR(_url)].as<const char*>())) {
      strlcpy(requestedUrl, top[FPSTR(_url)].as<const char*>(), sizeof(requestedUrl));
    } else rejectConfig(ConfigError::Url, valid);
    if (top[FPSTR(_deviceName)].is<const char*>() && validName(top[FPSTR(_deviceName)].as<const char*>())) {
      strlcpy(requestedName, top[FPSTR(_deviceName)].as<const char*>(), sizeof(requestedName));
    } else rejectConfig(ConfigError::DeviceName, valid);

    if (requestedSpectrumMapping < 0 || requestedSpectrumMapping > 1) rejectConfig(ConfigError::SpectrumMapping, valid);
    if (requestedSpectrumFloor < SENDSPIN_MIN_DB || requestedSpectrumFloor > SENDSPIN_MAX_DB) rejectConfig(ConfigError::SpectrumFloor, valid);
    if (requestedSpectrumCeiling < SENDSPIN_MIN_DB || requestedSpectrumCeiling > SENDSPIN_MAX_DB) rejectConfig(ConfigError::SpectrumCeiling, valid);
    if (requestedSpectrumBassTrim < SENDSPIN_MIN_TRIM_DB || requestedSpectrumBassTrim > SENDSPIN_MAX_TRIM_DB) rejectConfig(ConfigError::SpectrumBassTrim, valid);
    if (requestedSpectrumMidTrim < SENDSPIN_MIN_TRIM_DB || requestedSpectrumMidTrim > SENDSPIN_MAX_TRIM_DB) rejectConfig(ConfigError::SpectrumMidTrim, valid);
    if (requestedSpectrumTrebleTrim < SENDSPIN_MIN_TRIM_DB || requestedSpectrumTrebleTrim > SENDSPIN_MAX_TRIM_DB) rejectConfig(ConfigError::SpectrumTrebleTrim, valid);
    if (requestedSpectrumInputGate < SENDSPIN_MIN_DB || requestedSpectrumInputGate > SENDSPIN_MAX_DB) rejectConfig(ConfigError::SpectrumInputGate, valid);
    if (requestedSpectrumFloor >= requestedSpectrumCeiling || requestedSpectrumInputGate >= requestedSpectrumCeiling) {
      rejectConfig(ConfigError::SpectrumCombination, valid);
    }
    if (!valid) {
      // Returning false makes WLED rewrite defaults; rejected input must leave storage untouched.
      return true;
    }

    if (requestedOffset < -2000) requestedOffset = -2000;
    else if (requestedOffset > 2000) requestedOffset = 2000;
    const PeakSource requestedPeakSourceValue = static_cast<PeakSource>(requestedPeakSource);
    const SpectrumMapping requestedSpectrumMappingValue = static_cast<SpectrumMapping>(requestedSpectrumMapping);
    const bool adapterChanged = enabled_ != requestedEnabled || allowUnpaired_ != requestedAllowUnpaired ||
                                displayOffsetMs_ != requestedOffset || strncmp(url_, requestedUrl, sizeof(url_)) != 0 ||
                                strncmp(deviceName_, requestedName, sizeof(deviceName_)) != 0;
    const bool peakSourceChanged = peakSource_ != requestedPeakSourceValue;
    enabled_ = requestedEnabled;
    allowUnpaired_ = requestedAllowUnpaired;
    displayOffsetMs_ = requestedOffset;
    peakSource_ = requestedPeakSourceValue;
    spectrumConfigVersion_.fetch_add(1, std::memory_order_acq_rel);
    spectrumMapping_.store(requestedSpectrumMappingValue, std::memory_order_relaxed);
    spectrumFloorDb_.store(requestedSpectrumFloor, std::memory_order_relaxed);
    spectrumCeilingDb_.store(requestedSpectrumCeiling, std::memory_order_relaxed);
    spectrumBassTrimDb_.store(requestedSpectrumBassTrim, std::memory_order_relaxed);
    spectrumMidTrimDb_.store(requestedSpectrumMidTrim, std::memory_order_relaxed);
    spectrumTrebleTrimDb_.store(requestedSpectrumTrebleTrim, std::memory_order_relaxed);
    spectrumInputGateDb_.store(requestedSpectrumInputGate, std::memory_order_relaxed);
    spectrumConfigVersion_.fetch_add(1, std::memory_order_release);
    strlcpy(url_, requestedUrl, sizeof(url_));
    strlcpy(deviceName_, requestedName, sizeof(deviceName_));

    if (peakSourceChanged) {
      samplePeak_ = false;
      peakUntilMs_ = 0;
    }

    if (initDone_ && adapterChanged) {
      configDirty_ = true;
    }
    return true;
  }

  void appendConfigData(Print& uiScript) override {
    uiScript.print(F("dd=addDropdown('Sendspin','peak-source');"));
    uiScript.print(F("addOption(dd,'Both',0);"));
    uiScript.print(F("addOption(dd,'Beat only',1);"));
    uiScript.print(F("addOption(dd,'Transient only (default)',2);"));
    uiScript.print(F("dd=addDropdown('Sendspin','spectrum-mapping');"));
    uiScript.print(F("addOption(dd,'Raw (default)',0);"));
    uiScript.print(F("addOption(dd,'WLED compatibility',1);"));
    uiScript.print(F("for(let n of ['spectrum-floor-db','spectrum-ceiling-db','spectrum-input-gate-db']){let e=d.getElementsByName('Sendspin:'+n);if(e.length){e=e[e.length-1];e.min=-60;e.max=0;e.step=1;}}"));
    uiScript.print(F("for(let n of ['spectrum-bass-trim-db','spectrum-mid-trim-db','spectrum-treble-trim-db']){let e=d.getElementsByName('Sendspin:'+n);if(e.length){e=e[e.length-1];e.min=-24;e.max=24;e.step=1;}}"));
    uiScript.print(F("{let e=n=>{let a=d.getElementsByName('Sendspin:'+n);return a[a.length-1]},f=e('spectrum-floor-db'),c=e('spectrum-ceiling-db'),g=e('spectrum-input-gate-db');if(f&&c&&g){let v=()=>{c.setCustomValidity(+f.value>=+c.value?'Ceiling must exceed floor':'');g.setCustomValidity(+g.value>=+c.value?'Gate must be below ceiling':'')};f.addEventListener('input',v);c.addEventListener('input',v);g.addEventListener('input',v);v()}}"));
    uiScript.print(F("addInfo('Sendspin:url',1,'Full outbound ws:// or wss:// server URL.');"));
    uiScript.print(F("addInfo('Sendspin:device-name',1,'Leave blank to use the WLED device name.');"));
    uiScript.print(F("addInfo('Sendspin:display-offset-ms',1,'ms. Positive delivers earlier; negative delivers later.');"));
    uiScript.print(F("addInfo('Sendspin:allow-unpaired',1,'Explicit opt-in. Keep disabled after pairing.');"));
    uiScript.print(F("addInfo('Sendspin:peak-source',1,'Controls peak-reactive effects.');"));
    uiScript.print(F("addInfo('Sendspin:spectrum-mapping',1,'Compatibility maps a gated dB window with band trims.');"));
    uiScript.print(F("addInfo('Sendspin:spectrum-input-gate-db',1,'dB. Applied before trims; -60 gates exact silence only.');"));
  }

  void addToJsonInfo(JsonObject& root) override {
    JsonObject user = root["u"];
    if (user.isNull()) user = root.createNestedObject("u");

    JsonArray statusRow = user.createNestedArray(F("Sendspin status"));
    statusRow.add(stateName(state_.load(std::memory_order_relaxed)));
    if (configError_ != ConfigError::None) {
      statusRow.add(F("invalid setting rejected"));
      statusRow.add(configErrorName(configError_));
    }
    JsonArray mappingRow = user.createNestedArray(F("Sendspin spectrum mapping"));
    mappingRow.add(spectrumMapping_.load(std::memory_order_relaxed) == SpectrumMapping::Raw ? F("raw") : F("WLED compatibility"));
    mappingRow.add(spectrumFloorDb_.load(std::memory_order_relaxed));
    mappingRow.add(spectrumCeilingDb_.load(std::memory_order_relaxed));
    mappingRow.add(spectrumInputGateDb_.load(std::memory_order_relaxed));
    mappingRow.add(F(" floor / ceiling / input gate dB"));
    JsonArray trimRow = user.createNestedArray(F("Sendspin spectrum trims"));
    trimRow.add(spectrumBassTrimDb_.load(std::memory_order_relaxed));
    trimRow.add(spectrumMidTrimDb_.load(std::memory_order_relaxed));
    trimRow.add(spectrumTrebleTrimDb_.load(std::memory_order_relaxed));
    trimRow.add(F(" bass / mid / treble dB"));

    const uint32_t now = millis();
    if (!adapterStatusAvailable_.load(std::memory_order_acquire)) return;
    if (!diagnosticsValid_.load(std::memory_order_acquire)) {
      JsonArray diagnosticsRow = user.createNestedArray(F("Sendspin diagnostics"));
      diagnosticsRow.add(F("unavailable after contention"));
      return;
    }
    DiagnosticsSnapshot diagnostics{};
    if (!captureDiagnostics(diagnostics, now)) {
      JsonArray diagnosticsRow = user.createNestedArray(F("Sendspin diagnostics"));
      diagnosticsRow.add(F("busy"));
      return;
    }
    if (!diagnostics.adapterAvailable) return;
    // Mutable char arrays make ArduinoJson copy the stack-backed status strings into its document.
    SendspinAdapterStatus& status = diagnostics.adapterStatus;
    const uint32_t stageAgeMs = advanceCachedAge(status.debugStageAgeMs, diagnostics.adapterStatusCapturedMs, now);
    const uint32_t spectrumAgeMs = advanceCachedAge(status.lastSpectrumAgeMs, diagnostics.adapterStatusCapturedMs, now);
    const uint32_t frameAgeMs = advanceCachedAge(status.lastFrameAgeMs, diagnostics.adapterStatusCapturedMs, now);
    JsonArray clientRow = user.createNestedArray(F("Sendspin client"));
    clientRow.add(status.started ? F("started") : F("stopped"));
    clientRow.add(status.persistenceReady ? F("NVS ready") : F("NVS error"));
    JsonArray attemptsRow = user.createNestedArray(F("Sendspin attempts"));
    attemptsRow.add(diagnostics.connectAttempts);
    if (diagnostics.lastConnectAttemptMs != 0) {
      attemptsRow.add(now - diagnostics.lastConnectAttemptMs);
      attemptsRow.add(F(" ms ago"));
    }
    JsonArray stageRow = user.createNestedArray(F("Sendspin transport stage"));
    stageRow.add(status.debugStage);
    if (stageAgeMs != UINT32_MAX) {
      stageRow.add(stageAgeMs);
      stageRow.add(F(" ms ago"));
    }
    JsonArray heapRow = user.createNestedArray(F("Sendspin heap"));
    heapRow.add(ESP.getFreeHeap());
    heapRow.add(getContiguousFreeHeap());
    heapRow.add(F(" free / largest"));
    if (status.serverName[0] != '\0') {
      JsonArray serverRow = user.createNestedArray(F("Sendspin server"));
      serverRow.add(status.serverName);
    }
    JsonArray clockRow = user.createNestedArray(F("Sendspin clock"));
    clockRow.add(status.timeSynced ? F("synchronized") : F("not synchronized"));
    JsonArray streamRow = user.createNestedArray(F("Sendspin visualizer"));
    streamRow.add(status.streamActive ? F("active") : F("inactive"));
    JsonArray beatStreamRow = user.createNestedArray(F("Sendspin beat stream"));
    beatStreamRow.add(status.streamHasBeat ? F("beat data advertised") : F("no beat data advertised"));
    beatStreamRow.add(status.streamTracksDownbeats ? F("downbeats tracked") : F("no downbeat tracking"));
    beatStreamRow.add(status.beatCallbacks);
    beatStreamRow.add(status.downbeatCallbacks);
    beatStreamRow.add(status.transientCallbacks);
    beatStreamRow.add(F(" beats / downbeats / transients observed"));
    JsonArray offsetRow = user.createNestedArray(F("Sendspin display offset"));
    offsetRow.add(displayOffsetMs_);
    offsetRow.add(lastRequestedOffsetMs_);
    offsetRow.add(configReadCount_);
    offsetRow.add(F(" current / requested / reads"));
    JsonArray levelsRow = user.createNestedArray(F("Sendspin levels"));
    levelsRow.add(diagnostics.loudnessInput);
    levelsRow.add(diagnostics.volumeRaw);
    levelsRow.add(diagnostics.volumeSmoothed);
    levelsRow.add(diagnostics.lastPeakStrength);
    levelsRow.add(F(" loudness / raw / smooth / last onset"));
    JsonArray eventRow = user.createNestedArray(F("Sendspin event ages"));
    if (diagnostics.lastBeatMs == 0) eventRow.add(F("never"));
    else eventRow.add(now - diagnostics.lastBeatMs);
    if (diagnostics.lastDownbeatMs == 0) eventRow.add(F("never"));
    else eventRow.add(now - diagnostics.lastDownbeatMs);
    if (diagnostics.lastTransientMs == 0) eventRow.add(F("never"));
    else eventRow.add(now - diagnostics.lastTransientMs);
    eventRow.add(F(" beat / downbeat / transient ms"));
    JsonArray spectrumRow = user.createNestedArray(F("Sendspin spectrum input"));
    for (size_t i = 0; i < 16; i++) spectrumRow.add(diagnostics.spectrumInput[i]);
    JsonArray effectiveSpectrumRow = user.createNestedArray(F("Sendspin spectrum WLED"));
    for (size_t i = 0; i < 16; i++) effectiveSpectrumRow.add(diagnostics.spectrum[i]);
    JsonArray providerSpectrumRow = user.createNestedArray(F("Sendspin spectrum provided"));
    for (size_t i = 0; i < 16; i++) providerSpectrumRow.add(diagnostics.providerSpectrum[i]);
    JsonArray spectrumFlowRow = user.createNestedArray(F("Sendspin spectrum flow"));
    spectrumFlowRow.add(status.spectrumCallbacks);
    spectrumFlowRow.add(status.spectrumAccepted);
    spectrumFlowRow.add(status.spectrumCoalesced);
    spectrumFlowRow.add(status.spectrumInvalid);
    spectrumFlowRow.add(status.spectrumDropped);
    spectrumFlowRow.add(diagnostics.spectrumAppliedCount);
    spectrumFlowRow.add(diagnostics.providerReadCount);
    spectrumFlowRow.add(F(" callbacks / accepted / coalesced / invalid / dropped / applied / UM requests"));
    JsonArray spectrumAgeRow = user.createNestedArray(F("Sendspin spectrum ages"));
    if (spectrumAgeMs == UINT32_MAX) spectrumAgeRow.add(F("never"));
    else spectrumAgeRow.add(spectrumAgeMs);
    if (diagnostics.lastSpectrumAppliedMs == 0) spectrumAgeRow.add(F("never"));
    else spectrumAgeRow.add(now - diagnostics.lastSpectrumAppliedMs);
    if (diagnostics.lastProviderReadMs == 0) spectrumAgeRow.add(F("never"));
    else spectrumAgeRow.add(now - diagnostics.lastProviderReadMs);
    spectrumAgeRow.add(diagnostics.spectrumStaleTransitions);
    spectrumAgeRow.add(F(" accepted / applied / provided ms / stale transitions"));
    JsonArray band0Row = user.createNestedArray(F("Sendspin band 0 (10 s)"));
    if (diagnostics.band0SampleCount == 0) {
      band0Row.add(F("empty"));
    } else {
      band0Row.add(diagnostics.band0Minimum);
      band0Row.add(diagnostics.band0Maximum);
      band0Row.add(diagnostics.band0Average);
      band0Row.add(diagnostics.band0AboveThreshold);
      band0Row.add(diagnostics.band0SampleCount);
      band0Row.add(F(" min / max / avg / >128 / samples"));
    }
    JsonArray frameRow = user.createNestedArray(F("Sendspin last frame"));
    if (frameAgeMs == UINT32_MAX) frameRow.add(F("never"));
    else {
      frameRow.add(frameAgeMs);
      frameRow.add(F(" ms"));
    }
  }
};

const char SendspinUsermod::_name[] PROGMEM = "Sendspin";
const char SendspinUsermod::_enabled[] PROGMEM = "enabled";
const char SendspinUsermod::_url[] PROGMEM = "url";
const char SendspinUsermod::_deviceName[] PROGMEM = "device-name";
const char SendspinUsermod::_displayOffset[] PROGMEM = "display-offset-ms";
const char SendspinUsermod::_allowUnpaired[] PROGMEM = "allow-unpaired";
const char SendspinUsermod::_peakSource[] PROGMEM = "peak-source";
const char SendspinUsermod::_spectrumMapping[] PROGMEM = "spectrum-mapping";
const char SendspinUsermod::_spectrumFloor[] PROGMEM = "spectrum-floor-db";
const char SendspinUsermod::_spectrumCeiling[] PROGMEM = "spectrum-ceiling-db";
const char SendspinUsermod::_spectrumBassTrim[] PROGMEM = "spectrum-bass-trim-db";
const char SendspinUsermod::_spectrumMidTrim[] PROGMEM = "spectrum-mid-trim-db";
const char SendspinUsermod::_spectrumTrebleTrim[] PROGMEM = "spectrum-treble-trim-db";
const char SendspinUsermod::_spectrumInputGate[] PROGMEM = "spectrum-input-gate-db";

static SendspinUsermod sendspinUsermod;
REGISTER_USERMOD(sendspinUsermod);
// AI: end
