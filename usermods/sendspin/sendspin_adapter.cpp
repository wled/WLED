// AI: below section was generated by an AI
#include "sendspin_adapter.h"

#include <Preferences.h>
#include <esp_timer.h>
#include <esp_wifi.h>
#include <freertos/FreeRTOS.h>
#include <freertos/semphr.h>

#include <algorithm>
#include <array>
#include <atomic>
#include <cstdarg>
#include <cstdio>
#include <cstring>
#include <memory>
#include <new>
#include <optional>
#include <string>
#include <string_view>
#include <vector>

#include "sendspin/client.h"
#include "sendspin/config.h"
#include "sendspin/types.h"
#include "sendspin/visualizer_role.h"

namespace {

constexpr size_t SPECTRUM_BINS = 16;
constexpr size_t VISUALIZER_BUFFER_CAPACITY = 2048;
constexpr size_t MAX_PERSISTED_BLOB_SIZE = 1024;
constexpr uint16_t TRANSIENT_PRESENT = 0x0100;
constexpr uint16_t TRANSIENT_STRENGTH_MASK = 0x00ff;

enum class DebugStage : uint8_t {
  None,
  RequestHandled,
  WebSocketInitFailed,
  WebSocketStartFailed,
  WebSocketTaskStarted,
  WebSocketUpgraded,
  WebSocketError,
  WebSocketClosed,
  ClientInitAttempted,
  ServerInitReceived,
  NoiseMessage1Received,
  NoiseMessage2Attempted,
  NoiseEnvelopeInvalid,
  NoiseSessionFailed,
  NoiseMsg1AuthFailed,
  NoiseMsg1PayloadInvalid,
  NoiseMsg1Decoded,
  NoisePskMissing,
  NoisePskCategoryInvalid,
  NoisePskServerMismatch,
  NoiseSentinelUnavailable,
  NoisePskBindingFailed,
  NoiseMsg2GenerationFailed,
  NoiseMsg2SendFailed,
  ServerHelloReceived,
  ClientHelloAttempted,
  ServerActivateReceived,
  ClientTimeAttempted,
  ServerTimeReceived,
  StreamStartReceived,
  SendFailed,
  TimeoutTcpOpen,
  TimeoutWebSocketUp,
  TimeoutNoisePending,
  TimeoutNoiseDone,
  TimeoutHelloSent,
  TimeoutActivation,
  TimeoutEstablished,
  NoiseActive,
  Admitted,
};

std::atomic<DebugStage> debugStage{DebugStage::None};
std::atomic<uint32_t> debugStageMs{0};

void setDebugStage(DebugStage stage) {
  debugStageMs.store(static_cast<uint32_t>(esp_timer_get_time() / 1000LL), std::memory_order_relaxed);
  debugStage.store(stage, std::memory_order_release);
}

const char* debugStageName(DebugStage stage) {
  switch (stage) {
    case DebugStage::RequestHandled: return "connect request handled";
    case DebugStage::WebSocketInitFailed: return "websocket init failed";
    case DebugStage::WebSocketStartFailed: return "websocket start failed";
    case DebugStage::WebSocketTaskStarted: return "websocket task started";
    case DebugStage::WebSocketUpgraded: return "websocket upgraded";
    case DebugStage::WebSocketError: return "websocket error";
    case DebugStage::WebSocketClosed: return "websocket closed";
    case DebugStage::ClientInitAttempted: return "client/init send attempted";
    case DebugStage::ServerInitReceived: return "server/init received";
    case DebugStage::NoiseMessage1Received: return "Noise message 1 received";
    case DebugStage::NoiseMessage2Attempted: return "Noise message 2 send attempted";
    case DebugStage::NoiseEnvelopeInvalid: return "Noise message 1 envelope invalid";
    case DebugStage::NoiseSessionFailed: return "Noise session creation failed";
    case DebugStage::NoiseMsg1AuthFailed: return "Noise message 1 authentication failed";
    case DebugStage::NoiseMsg1PayloadInvalid: return "Noise message 1 payload invalid";
    case DebugStage::NoiseMsg1Decoded: return "Noise message 1 decoded";
    case DebugStage::NoisePskMissing: return "Noise PSK ID missing";
    case DebugStage::NoisePskCategoryInvalid: return "Noise PSK category invalid";
    case DebugStage::NoisePskServerMismatch: return "Noise PSK server mismatch";
    case DebugStage::NoiseSentinelUnavailable: return "Noise Sentinel PSK unavailable";
    case DebugStage::NoisePskBindingFailed: return "Noise PSK binding failed";
    case DebugStage::NoiseMsg2GenerationFailed: return "Noise message 2 generation failed";
    case DebugStage::NoiseMsg2SendFailed: return "Noise message 2 send failed";
    case DebugStage::ServerHelloReceived: return "server/hello received";
    case DebugStage::ClientHelloAttempted: return "client/hello send attempted";
    case DebugStage::ServerActivateReceived: return "server/activate received";
    case DebugStage::ClientTimeAttempted: return "client/time send attempted";
    case DebugStage::ServerTimeReceived: return "server/time received";
    case DebugStage::StreamStartReceived: return "stream/start received";
    case DebugStage::SendFailed: return "websocket send failed";
    case DebugStage::TimeoutTcpOpen: return "timeout: TCP_OPEN";
    case DebugStage::TimeoutWebSocketUp: return "timeout: WS_UP";
    case DebugStage::TimeoutNoisePending: return "timeout: NOISE_PENDING";
    case DebugStage::TimeoutNoiseDone: return "timeout: NOISE_DONE";
    case DebugStage::TimeoutHelloSent: return "timeout: HELLO_SENT";
    case DebugStage::TimeoutActivation: return "timeout: ACTIVATE_PENDING";
    case DebugStage::TimeoutEstablished: return "timeout: ESTABLISHED";
    case DebugStage::NoiseActive: return "Noise active";
    case DebugStage::Admitted: return "connection admitted";
    default: return "none";
  }
}

bool isDebugFailure(DebugStage stage) {
  switch (stage) {
    case DebugStage::WebSocketInitFailed:
    case DebugStage::WebSocketStartFailed:
    case DebugStage::WebSocketError:
    case DebugStage::NoiseEnvelopeInvalid:
    case DebugStage::NoiseSessionFailed:
    case DebugStage::NoiseMsg1AuthFailed:
    case DebugStage::NoiseMsg1PayloadInvalid:
    case DebugStage::NoisePskMissing:
    case DebugStage::NoisePskCategoryInvalid:
    case DebugStage::NoisePskServerMismatch:
    case DebugStage::NoiseSentinelUnavailable:
    case DebugStage::NoisePskBindingFailed:
    case DebugStage::NoiseMsg2GenerationFailed:
    case DebugStage::NoiseMsg2SendFailed:
    case DebugStage::SendFailed:
    case DebugStage::TimeoutTcpOpen:
    case DebugStage::TimeoutWebSocketUp:
    case DebugStage::TimeoutNoisePending:
    case DebugStage::TimeoutNoiseDone:
    case DebugStage::TimeoutHelloSent:
    case DebugStage::TimeoutActivation:
    case DebugStage::TimeoutEstablished:
      return true;
    default:
      return false;
  }
}

void captureDebugStage(const char* format, const char* nurseryStage) {
  if (strcmp(format, "Initiating client connection to: %s") == 0) {
    setDebugStage(DebugStage::RequestHandled);
  } else if (strcmp(format, "Failed to initialize websocket client") == 0) {
    setDebugStage(DebugStage::WebSocketInitFailed);
  } else if (strcmp(format, "Failed to start websocket client: %s") == 0) {
    setDebugStage(DebugStage::WebSocketStartFailed);
  } else if (strcmp(format, "Client connection starting to %s") == 0) {
    setDebugStage(DebugStage::WebSocketTaskStarted);
  } else if (strcmp(format, "WebSocket connected to %s") == 0) {
    setDebugStage(DebugStage::WebSocketUpgraded);
  } else if (strcmp(format, "WebSocket error on connection to %s") == 0) {
    setDebugStage(DebugStage::WebSocketError);
  } else if (strcmp(format, "WebSocket disconnected from %s") == 0) {
    if (!isDebugFailure(debugStage.load(std::memory_order_acquire))) setDebugStage(DebugStage::WebSocketClosed);
  } else if (strcmp(format, "Failed to send text message (timeout or error): %d") == 0 ||
             strcmp(format, "Failed to send binary message (timeout or error): %d") == 0) {
    setDebugStage(DebugStage::SendFailed);
  } else if (strcmp(format, "%s: missing data field") == 0 ||
             strcmp(format, "%s: failed to base64url-decode noise msg1") == 0) {
    setDebugStage(DebugStage::NoiseEnvelopeInvalid);
  } else if (strcmp(format, "%s: invalid server_id (cannot decode public key)") == 0 ||
             strcmp(format, "%s: failed to build session") == 0) {
    setDebugStage(DebugStage::NoiseSessionFailed);
  } else if (strcmp(format, "%s: read_msg1 failed (auth error in msg1 static DH)") == 0) {
    setDebugStage(DebugStage::NoiseMsg1AuthFailed);
  } else if (strcmp(format, "%s: failed to parse msg1 payload JSON") == 0) {
    setDebugStage(DebugStage::NoiseMsg1PayloadInvalid);
  } else if (strcmp(format, "%s: psk_id='%s' psk_category='%s'") == 0) {
    setDebugStage(DebugStage::NoiseMsg1Decoded);
  } else if (strcmp(format, "%s: psk_id missing from msg1 payload") == 0) {
    setDebugStage(DebugStage::NoisePskMissing);
  } else if (strcmp(format, "%s: msg1 payload psk_category missing or unknown ('%s')") == 0) {
    setDebugStage(DebugStage::NoisePskCategoryInvalid);
  } else if (strcmp(format, "%s: PSK bound to server_id='%s', but connected to '%s'") == 0) {
    setDebugStage(DebugStage::NoisePskServerMismatch);
  } else if (strcmp(format, "%s: the Sentinel PSK did not resolve") == 0) {
    setDebugStage(DebugStage::NoiseSentinelUnavailable);
  } else if (strcmp(format, "%s: failed to bind resolved PSK") == 0) {
    setDebugStage(DebugStage::NoisePskBindingFailed);
  } else if (strcmp(format, "%s: write_msg2_and_split failed") == 0) {
    setDebugStage(DebugStage::NoiseMsg2GenerationFailed);
  } else if (strcmp(format, "handle_msg1: failed to send noise/handshake msg2") == 0) {
    setDebugStage(DebugStage::NoiseMsg2SendFailed);
  } else if (strcmp(format, "Noise transport active (server_id=%s, psk_category=%d)") == 0) {
    setDebugStage(DebugStage::NoiseActive);
  } else if (strcmp(format, "Connection admitted: server_id=%s") == 0) {
    setDebugStage(DebugStage::Admitted);
  } else if (strcmp(format, "Nursery connection stalled at %s (>%d s), dropping") == 0) {
    if (nurseryStage == nullptr) return;
    if (strcmp(nurseryStage, "TCP_OPEN") == 0) setDebugStage(DebugStage::TimeoutTcpOpen);
    else if (strcmp(nurseryStage, "WS_UP") == 0) setDebugStage(DebugStage::TimeoutWebSocketUp);
    else if (strcmp(nurseryStage, "NOISE_PENDING") == 0) setDebugStage(DebugStage::TimeoutNoisePending);
    else if (strcmp(nurseryStage, "NOISE_DONE") == 0) setDebugStage(DebugStage::TimeoutNoiseDone);
    else if (strcmp(nurseryStage, "HELLO_SENT") == 0) setDebugStage(DebugStage::TimeoutHelloSent);
    else if (strcmp(nurseryStage, "ACTIVATE_PENDING") == 0) setDebugStage(DebugStage::TimeoutActivation);
    else if (strcmp(nurseryStage, "ESTABLISHED") == 0) setDebugStage(DebugStage::TimeoutEstablished);
  }
}

bool traceHasType(const sendspin::SendspinTracedMessage& message, std::string_view type) {
  if (message.plaintext == nullptr || message.plaintext_len == 0) return false;
  const std::string_view text(reinterpret_cast<const char*>(message.plaintext), message.plaintext_len);
  const size_t key = text.find("\"type\":\"");
  if (key == std::string_view::npos) return false;
  const size_t value = key + sizeof("\"type\":\"") - 1;
  return text.substr(value, type.size()) == type && value + type.size() < text.size() && text[value + type.size()] == '"';
}

// Reduce the redacted upstream trace to non-sensitive protocol milestones.
void captureMessageTrace(const sendspin::SendspinTracedMessage& message) {
  const bool inbound = message.direction == sendspin::SendspinTraceDirection::INBOUND;
  if (!inbound && traceHasType(message, "client/init")) setDebugStage(DebugStage::ClientInitAttempted);
  else if (inbound && traceHasType(message, "server/init")) setDebugStage(DebugStage::ServerInitReceived);
  else if (inbound && traceHasType(message, "noise/handshake")) setDebugStage(DebugStage::NoiseMessage1Received);
  else if (!inbound && traceHasType(message, "noise/handshake")) setDebugStage(DebugStage::NoiseMessage2Attempted);
  else if (inbound && traceHasType(message, "server/hello")) setDebugStage(DebugStage::ServerHelloReceived);
  else if (!inbound && traceHasType(message, "client/hello")) setDebugStage(DebugStage::ClientHelloAttempted);
  else if (inbound && traceHasType(message, "server/activate")) setDebugStage(DebugStage::ServerActivateReceived);
  else if (!inbound && traceHasType(message, "client/time")) setDebugStage(DebugStage::ClientTimeAttempted);
  else if (inbound && traceHasType(message, "server/time")) setDebugStage(DebugStage::ServerTimeReceived);
  else if (inbound && traceHasType(message, "stream/start")) setDebugStage(DebugStage::StreamStartReceived);
}

uint32_t monotonicMs() {
  return static_cast<uint32_t>(esp_timer_get_time() / 1000LL);
}

class NetworkProvider final : public sendspin::SendspinNetworkProvider {
public:
  bool is_network_ready() override { return ready_.load(std::memory_order_relaxed); }
  void setReady(bool ready) { ready_.store(ready, std::memory_order_relaxed); }

private:
  std::atomic<bool> ready_{false};
};

class PersistenceProvider final : public sendspin::SendspinPersistenceProvider {
public:
  PersistenceProvider() : ready_(preferences_.begin("sendspin", false)) {}
  ~PersistenceProvider() override {
    if (ready_) preferences_.end();
  }

  bool ready() const { return ready_; }

  // Sendspin owns the blob format; this provider only enforces NVS key and size bounds.
  std::optional<std::vector<uint8_t>> load_blob(const std::string& key) override {
    if (!validKey(key)) return std::nullopt;
    const size_t len = preferences_.getBytesLength(key.c_str());
    if (len == 0 || len > MAX_PERSISTED_BLOB_SIZE) return std::nullopt;

    std::vector<uint8_t> data(len);
    if (preferences_.getBytes(key.c_str(), data.data(), len) != len) return std::nullopt;
    return data;
  }

  bool save_blob(const std::string& key, const uint8_t* data, size_t len) override {
    if (!validKey(key) || data == nullptr || len == 0 || len > MAX_PERSISTED_BLOB_SIZE) return false;
    return preferences_.putBytes(key.c_str(), data, len) == len;
  }

private:
  static bool validKey(const std::string& key) {
    return !key.empty() && key.size() <= 15 && key.find('\0') == std::string::npos;
  }

  Preferences preferences_;
  bool ready_;
};

}  // namespace

extern "C" void sendspinDiagnosticLog(char, const char*, const char* format, ...) {
  const char* nurseryStage = nullptr;
  if (strcmp(format, "Nursery connection stalled at %s (>%d s), dropping") == 0) {
    va_list args;
    va_start(args, format);
    nurseryStage = va_arg(args, const char*);
    va_end(args);
  }
  captureDebugStage(format, nurseryStage);
}

class SendspinAdapter final : public sendspin::SendspinClientListener,
                              public sendspin::VisualizerRoleListener {
public:
  explicit SendspinAdapter(const SendspinAdapterConfig& config)
      : restoreWifiSleep_(config.restoreWifiSleep), mailboxMutex_(xSemaphoreCreateMutex()) {
    setDebugStage(DebugStage::None);

    sendspin::SendspinClientConfig clientConfig;
    clientConfig.name = config.name != nullptr ? config.name : "WLED";
    clientConfig.product_name = "WLED Sendspin Visualizer";
    clientConfig.manufacturer = "WLED";
    clientConfig.software_version = "17.0.0-dev";
    clientConfig.max_pairing_records = 5;
    const bool psramAvailable = psramFound() && ESP.getPsramSize() > 0;
    clientConfig.inbound_ring_location = psramAvailable ? sendspin::MemoryLocation::PREFER_EXTERNAL
                                                        : sendspin::MemoryLocation::PREFER_INTERNAL;
    clientConfig.noise_buffer_location = psramAvailable ? sendspin::MemoryLocation::PREFER_EXTERNAL
                                                        : sendspin::MemoryLocation::PREFER_INTERNAL;
    clientConfig.message_trace = captureMessageTrace;

    client_ = std::make_unique<sendspin::SendspinClient>(std::move(clientConfig));
    client_->set_listener(this);
    client_->set_network_provider(&networkProvider_);
    client_->set_persistence_provider(&persistenceProvider_);
    client_->set_unpaired_access_enabled(config.allowUnpaired);

    sendspin::VisualizerRoleConfig visualizerConfig;
    visualizerConfig.support.buffer_capacity = VISUALIZER_BUFFER_CAPACITY;
    visualizerConfig.stream.types = {
        sendspin::VisualizerDataType::LOUDNESS,
        sendspin::VisualizerDataType::SPECTRUM,
        sendspin::VisualizerDataType::F_PEAK,
        sendspin::VisualizerDataType::PEAK,
        sendspin::VisualizerDataType::BEAT,
    };
    visualizerConfig.stream.rate_max = 30;
    visualizerConfig.stream.spectrum = sendspin::VisualizerSpectrumConfig{
        .n_disp_bins = SPECTRUM_BINS,
        .scale = sendspin::VisualizerSpectrumScale::LOG,
        .f_min = 43,
        .f_max = 9259,
    };
    visualizerConfig.display_offset_ms = config.displayOffsetMs;
    client_->add_visualizer(std::move(visualizerConfig)).set_listener(this);
  }

  ~SendspinAdapter() override {
    stop();
    if (mailboxMutex_ != nullptr) vSemaphoreDelete(mailboxMutex_);
  }

  bool usable() const { return mailboxMutex_ != nullptr && persistenceProvider_.ready(); }

  bool start() {
    if (!usable()) return false;
    return client_->start();
  }

  void stop() {
    if (client_ != nullptr) client_->stop();
    requestClear();
  }

  void loop(bool networkReady) {
    networkProvider_.setReady(networkReady);
    client_->loop();
  }

  void connect(const char* url) {
    if (url != nullptr && url[0] != '\0') client_->connect_to(url);
  }

  bool takeFrame(SendspinAdapterFrame& frame) {
    if (xSemaphoreTake(mailboxMutex_, pdMS_TO_TICKS(2)) != pdTRUE) return false;
    const bool clearRequested = clearRequested_.exchange(false, std::memory_order_acq_rel);
    const bool hasUpdate = mailboxDirty_ || pendingEvents_.load(std::memory_order_acquire) != 0 ||
                           pendingTransient_.load(std::memory_order_acquire) != 0 || clearRequested;
    if (hasUpdate) {
      frame = mailbox_;
      frame.events = pendingEvents_.exchange(0, std::memory_order_acq_rel);
      const uint16_t transient = pendingTransient_.exchange(0, std::memory_order_acq_rel);
      if ((transient & TRANSIENT_PRESENT) != 0) frame.events |= SENDSPIN_EVENT_TRANSIENT;
      frame.peakStrength = static_cast<uint8_t>(transient & TRANSIENT_STRENGTH_MASK);
      frame.spectrumUpdated = mailboxSpectrumDirty_;
      frame.streamActive = streamActive_.load(std::memory_order_acquire);
      frame.clear = !frame.streamActive;
      mailboxDirty_ = false;
      mailboxSpectrumDirty_ = false;
    }
    xSemaphoreGive(mailboxMutex_);
    return hasUpdate;
  }

  void getStatus(SendspinAdapterStatus& status) const {
    std::memset(&status, 0, sizeof(status));
    status.started = client_->is_started();
    status.connected = client_->is_connected();
    status.timeSynced = client_->is_time_synced();
    status.streamActive = streamActive_.load(std::memory_order_acquire);
    status.streamHasBeat = streamHasBeat_.load(std::memory_order_relaxed);
    status.streamTracksDownbeats = streamTracksDownbeats_.load(std::memory_order_relaxed);
    status.persistenceReady = persistenceProvider_.ready();
    const uint32_t lastFrame = lastFrameMs_.load(std::memory_order_relaxed);
    status.lastFrameAgeMs = lastFrame == 0 ? UINT32_MAX : monotonicMs() - lastFrame;
    const uint32_t lastSpectrum = lastSpectrumMs_.load(std::memory_order_relaxed);
    status.lastSpectrumAgeMs = lastSpectrum == 0 ? UINT32_MAX : monotonicMs() - lastSpectrum;
    status.spectrumCallbacks = spectrumCallbacks_.load(std::memory_order_relaxed);
    status.spectrumAccepted = spectrumAccepted_.load(std::memory_order_relaxed);
    status.spectrumCoalesced = spectrumCoalesced_.load(std::memory_order_relaxed);
    status.spectrumInvalid = spectrumInvalid_.load(std::memory_order_relaxed);
    status.spectrumDropped = spectrumDropped_.load(std::memory_order_relaxed);
    status.beatCallbacks = beatCallbacks_.load(std::memory_order_relaxed);
    status.downbeatCallbacks = downbeatCallbacks_.load(std::memory_order_relaxed);
    status.transientCallbacks = transientCallbacks_.load(std::memory_order_relaxed);

    const auto server = client_->get_server_information();
    if (server.has_value()) copySanitizedName(server->name, status.serverName, sizeof(status.serverName));
    const DebugStage stage = debugStage.load(std::memory_order_acquire);
    const uint32_t stageMs = debugStageMs.load(std::memory_order_relaxed);
    status.debugStageAgeMs = stage == DebugStage::None ? UINT32_MAX : monotonicMs() - stageMs;
    snprintf(status.debugStage, sizeof(status.debugStage), "%s", debugStageName(stage));
  }

  void on_request_high_performance() override {
    esp_wifi_set_ps(WIFI_PS_NONE);
  }

  void on_release_high_performance() override {
    esp_wifi_set_ps(restoreWifiSleep_ ? WIFI_PS_MIN_MODEM : WIFI_PS_NONE);
  }

  void on_loudness(int64_t, uint16_t loudness) override {
    if (!lockMailboxFromCallback()) return;
    mailbox_.loudness = loudness;
    finishMailboxUpdate();
  }

  void on_beat(int64_t, bool downbeat) override {
    beatCallbacks_.fetch_add(1, std::memory_order_relaxed);
    if (downbeat) downbeatCallbacks_.fetch_add(1, std::memory_order_relaxed);
    const uint8_t event = SENDSPIN_EVENT_BEAT | (downbeat ? SENDSPIN_EVENT_DOWNBEAT : 0);
    pendingEvents_.fetch_or(event, std::memory_order_release);
    markFrameReceived();
  }

  void on_f_peak(int64_t, uint16_t frequencyHz, uint16_t amplitude) override {
    if (!lockMailboxFromCallback()) return;
    mailbox_.peakFrequency = frequencyHz;
    mailbox_.peakAmplitude = amplitude;
    finishMailboxUpdate();
  }

  void on_spectrum(int64_t, const std::vector<uint16_t>& bins) override {
    spectrumCallbacks_.fetch_add(1, std::memory_order_relaxed);
    if (bins.size() != SPECTRUM_BINS) {
      spectrumInvalid_.fetch_add(1, std::memory_order_relaxed);
      return;
    }
    if (!lockMailboxFromCallback()) {
      spectrumDropped_.fetch_add(1, std::memory_order_relaxed);
      return;
    }
    if (mailboxSpectrumDirty_) spectrumCoalesced_.fetch_add(1, std::memory_order_relaxed);
    std::copy_n(bins.begin(), SPECTRUM_BINS, mailbox_.spectrum);
    mailboxSpectrumDirty_ = true;
    spectrumAccepted_.fetch_add(1, std::memory_order_relaxed);
    lastSpectrumMs_.store(monotonicMs(), std::memory_order_relaxed);
    finishMailboxUpdate();
  }

  void on_peak(int64_t, uint8_t strength) override {
    transientCallbacks_.fetch_add(1, std::memory_order_relaxed);
    // Presence and maximum strength must be drained atomically as one transient snapshot.
    uint16_t pending = pendingTransient_.load(std::memory_order_relaxed);
    uint16_t updated;
    do {
      updated = TRANSIENT_PRESENT |
                std::max<uint16_t>(pending & TRANSIENT_STRENGTH_MASK, strength);
    } while (!pendingTransient_.compare_exchange_weak(
        pending, updated, std::memory_order_release, std::memory_order_relaxed));
    markFrameReceived();
  }

  void on_visualizer_stream_start(const sendspin::ServerVisualizerStreamObject& stream) override {
    const bool hasBeat = std::find(stream.types.begin(), stream.types.end(), sendspin::VisualizerDataType::BEAT) != stream.types.end();
    streamHasBeat_.store(hasBeat, std::memory_order_relaxed);
    streamTracksDownbeats_.store(hasBeat && stream.tracks_downbeats, std::memory_order_relaxed);
    beatCallbacks_.store(0, std::memory_order_relaxed);
    downbeatCallbacks_.store(0, std::memory_order_relaxed);
    transientCallbacks_.store(0, std::memory_order_relaxed);
    streamActive_.store(true, std::memory_order_release);
  }

  void on_visualizer_stream_end() override { requestClear(); }
  void on_visualizer_stream_clear() override { requestClear(); }

private:
  static void copySanitizedName(const std::string& source, char* destination, size_t capacity) {
    if (capacity == 0) return;
    const size_t count = std::min(source.size(), capacity - 1);
    for (size_t i = 0; i < count; i++) {
      const unsigned char value = static_cast<unsigned char>(source[i]);
      destination[i] = (value >= 0x20 && value <= 0x7e && value != '<' && value != '>' && value != '&')
                           ? static_cast<char>(value)
                           : '_';
    }
    destination[count] = '\0';
  }

  bool lockMailboxFromCallback() {
    return xSemaphoreTake(mailboxMutex_, 0) == pdTRUE;
  }

  void finishMailboxUpdate() {
    mailboxDirty_ = true;
    markFrameReceived();
    xSemaphoreGive(mailboxMutex_);
  }

  void markFrameReceived() { lastFrameMs_.store(monotonicMs(), std::memory_order_relaxed); }

  void requestClear() {
    streamHasBeat_.store(false, std::memory_order_relaxed);
    streamTracksDownbeats_.store(false, std::memory_order_relaxed);
    beatCallbacks_.store(0, std::memory_order_relaxed);
    downbeatCallbacks_.store(0, std::memory_order_relaxed);
    transientCallbacks_.store(0, std::memory_order_relaxed);
    streamActive_.store(false, std::memory_order_release);
    pendingEvents_.store(0, std::memory_order_release);
    pendingTransient_.store(0, std::memory_order_release);
    clearRequested_.store(true, std::memory_order_release);
    if (mailboxMutex_ == nullptr || xSemaphoreTake(mailboxMutex_, pdMS_TO_TICKS(2)) != pdTRUE) return;
    mailbox_ = {};
    mailboxDirty_ = true;
    mailboxSpectrumDirty_ = false;
    xSemaphoreGive(mailboxMutex_);
  }

  NetworkProvider networkProvider_;
  PersistenceProvider persistenceProvider_;
  std::unique_ptr<sendspin::SendspinClient> client_;
  bool restoreWifiSleep_;
  SemaphoreHandle_t mailboxMutex_;
  SendspinAdapterFrame mailbox_{};
  bool mailboxDirty_{false};
  bool mailboxSpectrumDirty_{false};
  std::atomic<uint8_t> pendingEvents_{0};
  std::atomic<uint16_t> pendingTransient_{0};
  std::atomic<bool> streamActive_{false};
  std::atomic<bool> streamHasBeat_{false};
  std::atomic<bool> streamTracksDownbeats_{false};
  std::atomic<bool> clearRequested_{false};
  std::atomic<uint32_t> lastFrameMs_{0};
  std::atomic<uint32_t> lastSpectrumMs_{0};
  std::atomic<uint32_t> spectrumCallbacks_{0};
  std::atomic<uint32_t> spectrumAccepted_{0};
  std::atomic<uint32_t> spectrumCoalesced_{0};
  std::atomic<uint32_t> spectrumInvalid_{0};
  std::atomic<uint32_t> spectrumDropped_{0};
  std::atomic<uint32_t> beatCallbacks_{0};
  std::atomic<uint32_t> downbeatCallbacks_{0};
  std::atomic<uint32_t> transientCallbacks_{0};
};

SendspinAdapter* sendspinAdapterCreate(const SendspinAdapterConfig& config) {
  auto* adapter = new (std::nothrow) SendspinAdapter(config);
  if (adapter == nullptr || !adapter->usable()) {
    delete adapter;
    return nullptr;
  }
  return adapter;
}

void sendspinAdapterDestroy(SendspinAdapter* adapter) { delete adapter; }
bool sendspinAdapterStart(SendspinAdapter* adapter) { return adapter != nullptr && adapter->start(); }
void sendspinAdapterLoop(SendspinAdapter* adapter, bool networkReady) { if (adapter != nullptr) adapter->loop(networkReady); }
void sendspinAdapterConnect(SendspinAdapter* adapter, const char* url) { if (adapter != nullptr) adapter->connect(url); }
bool sendspinAdapterTakeFrame(SendspinAdapter* adapter, SendspinAdapterFrame& frame) { return adapter != nullptr && adapter->takeFrame(frame); }
void sendspinAdapterGetStatus(const SendspinAdapter* adapter, SendspinAdapterStatus& status) {
  if (adapter != nullptr) adapter->getStatus(status);
  else std::memset(&status, 0, sizeof(status));
}
// AI: end
