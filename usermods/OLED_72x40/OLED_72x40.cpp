#include "wled.h"
#include <U8g2lib.h>

// 128x40 bitmap of Akemi logo, generated by LCD Matrix Studio
const unsigned char akemi_logo [] PROGMEM = {
  0x00, 0x00, 0x00, 0x00, 0x00, 0x00, 0x00, 0x00, 0x00, 0x00, 0x00, 0x00,
  0x00, 0x00, 0x00, 0x00, 0x00, 0x00, 0x00, 0x00, 0x00, 0x30, 0x00, 0x00,
  0x00, 0x00, 0x00, 0x00, 0x00, 0x00, 0x00, 0x00, 0x00, 0x00, 0x00, 0x00,
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  0x00, 0x00, 0x00, 0x00
};


class UsermodOLED72x40 : public Usermod {
  private:
    U8G2_SSD1306_128X64_NONAME_F_HW_I2C *u8g2 = nullptr;
    bool enabled = true;
    bool setupFailed = false;
    bool initDone = false;
    unsigned long lastUpdate = 0;
    unsigned long lastInteraction = 0;
    unsigned long screenTimeoutMS = 60000;
    int xOff = 28;
    int yOff = 24;
    byte vValues[72] = {};
    bool flipDisplay = false;
    int8_t buttonIndex = 0;
    int8_t ledPin = 8;
    int8_t activeLedPin = -1;

    enum DisplayState : uint8_t { SPLASH, DASHBOARD, OFF };
    DisplayState displayState = SPLASH;
    unsigned long splashStartTime = 0;
    static constexpr unsigned long SPLASH_DURATION = 5000;

    static const char _name[];
    static const char _enabled[];

  public:
    void setup() override {
      if (!enabled) return;

      // Use WLED's global I2C pins; user must configure them in LED Preferences
      if (i2c_sda < 0 || i2c_scl < 0) {
        setupFailed = true;
        return;
      }

      // Allocate LED pin for heartbeat indicator
      if (ledPin >= 0 && PinManager::allocatePin(ledPin, true, PinOwner::UM_Unspecified)) {
        activeLedPin = ledPin;
        pinMode(activeLedPin, OUTPUT);
      }

      u8g2 = new U8G2_SSD1306_128X64_NONAME_F_HW_I2C(U8G2_R0, U8X8_PIN_NONE);

      if (!u8g2->begin()) {
        if (activeLedPin >= 0) {
          PinManager::deallocatePin(activeLedPin, PinOwner::UM_Unspecified);
          activeLedPin = -1;
        }
        delete u8g2;
        u8g2 = nullptr;
        setupFailed = true;
        return;
      }

      u8g2->setContrast(255);
      u8g2->setFlipMode(flipDisplay ? 1 : 0);
      u8g2->clearBuffer();

      // Draw splash screen (non-blocking: no delay, handled in loop())
      int splashY = flipDisplay ? (64 - 40 - yOff) : yOff;
      u8g2->drawBitmap(0, splashY, 16, 40, akemi_logo);

      int textX = flipDisplay ? (128 - 72 - xOff) : xOff;
      u8g2->setFont(u8g2_font_4x6_tf);
      u8g2->setCursor(textX + 12, splashY + 38);
      if (Network.isConnected()) u8g2->print(Network.localIP());
      else u8g2->print(cmDNS);

      u8g2->sendBuffer();
      splashStartTime = millis();
      displayState = SPLASH;
      lastInteraction = millis();
      initDone = true;
    }

    void loop() override {
      if (!enabled || setupFailed || !initDone || !u8g2) return;

      // LED heartbeat
      if (activeLedPin >= 0) {
        static unsigned long ledTimer = 0;
        if (!Network.isConnected()) {
          if (millis() - ledTimer > 200) {
            ledTimer = millis();
            digitalWrite(activeLedPin, !digitalRead(activeLedPin));
          }
        } else {
          float pulse = (sin(millis() / 2000.0 * PI) + 1) * 127.5;
          analogWrite(activeLedPin, (int)pulse);
        }
      }

      // Non-blocking splash: wait for duration, then switch to dashboard
      if (displayState == SPLASH) {
        if (millis() - splashStartTime >= SPLASH_DURATION) {
          displayState = DASHBOARD;
          lastUpdate = 0; // force immediate dashboard redraw
        }
        return;
      }

      // Timeout logic: blank screen after inactivity
      if (screenTimeoutMS > 0 && (millis() - lastInteraction > screenTimeoutMS)) {
        if (displayState != OFF) {
          u8g2->setPowerSave(1);
          displayState = OFF;
        }
        return;
      }

      // Allow display updates even with long LED strips, just rate-limited
      if (strip.isUpdating() && (millis() - lastUpdate < 100)) return;

      if (millis() - lastUpdate > 100) {
        lastUpdate = millis();
        if (displayState == OFF) {
          u8g2->setPowerSave(0);
          displayState = DASHBOARD;
        }

        u8g2->clearBuffer();

        int currentX = flipDisplay ? (128 - 72 - xOff) : xOff;
        int currentY = flipDisplay ? (64 - 40 - yOff) : yOff;

        // Effect name
        u8g2->setFont(u8g2_font_5x7_tf);
        char lineBuffer[17];
        extractModeName(effectCurrent, JSON_mode_names, lineBuffer, 16);
        u8g2->drawStr(currentX, currentY + 7, lineBuffer);
        u8g2->drawHLine(currentX, currentY + 9, 72);

        // Brightness history graph (scrolling)
        for (int i = 0; i < 71; i++) vValues[i] = vValues[i + 1];
        vValues[71] = map(bri, 0, 255, 0, 15);
        for (int i = 0; i < 72; i++) {
          u8g2->drawLine(currentX + i, currentY + 26, currentX + i, currentY + 26 - vValues[i]);
        }

        // Stats line: Speed, Intensity, Brightness
        u8g2->setFont(u8g2_font_4x6_tf);
        u8g2->setCursor(currentX, currentY + 38);
        u8g2->print("S:"); u8g2->print(map(effectSpeed, 0, 255, 0, 99)); u8g2->print("% ");
        u8g2->print("I:"); u8g2->print(map(effectIntensity, 0, 255, 0, 99)); u8g2->print("% ");
        u8g2->print("B:"); u8g2->print(map(bri, 0, 255, 0, 100)); u8g2->print("%");

        u8g2->sendBuffer();
      }
    }

    void onStateChange(uint8_t mode) override {
      lastInteraction = millis();
      lastUpdate = 0;
      if (displayState == OFF && u8g2) {
        u8g2->setPowerSave(0);
        displayState = DASHBOARD;
      }
    }

    bool handleButton(uint8_t b) override {
      if (b != buttonIndex) return false;
      lastInteraction = millis();
      if (displayState == OFF && u8g2) {
        u8g2->setPowerSave(0);
        displayState = DASHBOARD;
      }
      return false; // let WLED core handle the actual button action
    }

    void addToConfig(JsonObject &root) override {
      JsonObject top = root.createNestedObject(FPSTR(_name));
      top[FPSTR(_enabled)] = enabled;
      top[F("flipDisplay")] = flipDisplay;
      top[F("x-offset")] = xOff;
      top[F("y-offset")] = yOff;
      top[F("sleepTimeout")] = screenTimeoutMS / 1000;
      top[F("buttonIndex")] = buttonIndex;
      top[F("ledPin")] = ledPin;
    }

    bool readFromConfig(JsonObject &root) override {
      JsonObject top = root[FPSTR(_name)];
      bool configComplete = !top.isNull();

      configComplete &= getJsonValue(top[FPSTR(_enabled)], enabled, true);
      configComplete &= getJsonValue(top[F("flipDisplay")], flipDisplay, false);
      configComplete &= getJsonValue(top[F("x-offset")], xOff, 28);
      configComplete &= getJsonValue(top[F("y-offset")], yOff, 24);
      unsigned long timeoutSec = screenTimeoutMS / 1000;
      configComplete &= getJsonValue(top[F("sleepTimeout")], timeoutSec, 60UL);
      screenTimeoutMS = timeoutSec * 1000;
      configComplete &= getJsonValue(top[F("buttonIndex")], buttonIndex, (int8_t)0);

      int8_t oldLedPin = ledPin;
      configComplete &= getJsonValue(top[F("ledPin")], ledPin, (int8_t)8);
      if (initDone && oldLedPin != ledPin) {
        if (activeLedPin >= 0) PinManager::deallocatePin(activeLedPin, PinOwner::UM_Unspecified);
        activeLedPin = -1;
        if (ledPin >= 0 && PinManager::allocatePin(ledPin, true, PinOwner::UM_Unspecified)) {
          activeLedPin = ledPin;
          pinMode(activeLedPin, OUTPUT);
        }
      }

      if (initDone && u8g2) u8g2->setFlipMode(flipDisplay ? 1 : 0);
      return configComplete;
    }

    void appendConfigData() override {
      oappend(SET_F("addInfo('OLED_72x40:x-offset',1,'pixels');"));
      oappend(SET_F("addInfo('OLED_72x40:y-offset',1,'pixels');"));
      oappend(SET_F("addInfo('OLED_72x40:sleepTimeout',1,'seconds (0=never)');"));
      oappend(SET_F("addInfo('OLED_72x40:buttonIndex',1,'WLED button index');"));
      oappend(SET_F("addInfo('OLED_72x40:ledPin',1,'GPIO (-1=disable)');"));
    }

    uint16_t getId() override { return USERMOD_ID_OLED_72x40; }
};

const char UsermodOLED72x40::_name[]    PROGMEM = "OLED_72x40";
const char UsermodOLED72x40::_enabled[] PROGMEM = "enabled";

static UsermodOLED72x40 oled_72x40;
REGISTER_USERMOD(oled_72x40);
